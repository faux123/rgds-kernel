## drivers/net/wireless/rockchip_wlan/rkwifi/Kconfig
```kconfig
# SPDX-License-Identifier: GPL-2.0
config AP6XXX
	tristate "ap6xxx wireless cards support"
	depends on RFKILL_RK
	select CFG80211
	select MAC80211
	help
	  This module adds support for wireless adapters based on
	  Broadcom ap6xxx chipset.

	  This driver uses the kernel's wireless extensions subsystem.

	  If you choose to build a module, it'll be called dhd. Say M if
	  unsure.

# Reconstructed: stock V1.21 /proc/config.gz lists "# CONFIG_RTL8821CS is not set"
# right after AP6XXX. The Realtek driver itself is not in the stock image
# (no rtl8821/rtw_ strings), so only the symbol is carried here.
config RTL8821CS
	tristate "Realtek 8821C SDIO WiFi"
	help
	  Realtek RTL8821CS SDIO Wi-Fi. The driver source is not part of
	  this tree; this entry only keeps the stock configuration intact.

choice
	prompt "Enable Chip Interface"
	depends on BCMDHD
	default BCMDHD_SDIO
	help
	  Enable Chip Interface.

config BCMDHD_SDIO
	bool "SDIO bus interface support"
	depends on BCMDHD && MMC

config BCMDHD_PCIE
	bool "PCIe bus interface support"
	depends on BCMDHD && PCI

endchoice

config PCIEASPM_ROCKCHIP_WIFI_EXTENSION
	bool "Extend ASPM function"
	depends on BCMDHD_PCIE && PCIEASPM_EXT
	help
	  This enables the extensions APIs for ASPM control.

config BCMDHD_FW_PATH
	depends on BCMDHD
	string "Firmware path"
	default "/vendor/etc/firmware/fw_bcmdhd.bin"
	help
	  Path to the firmware file.

config BCMDHD_NVRAM_PATH
	depends on BCMDHD
	string "NVRAM path"
	default "/vendor/etc/firmware/nvram.txt"
	help
	  Path to the calibration file.a

config BCMDHD_STATIC_IF
	bool "Enable wlan1 support"
	help
	  default to add wlan1 interface
```

## drivers/staging/android/Kconfig
```kconfig
# SPDX-License-Identifier: GPL-2.0
menu "Android"

config ASHMEM
	bool "Enable the Anonymous Shared Memory Subsystem"
	depends on SHMEM
	help
	  The ashmem subsystem is a new shared memory allocator, similar to
	  POSIX SHM but with different behavior and sporting a simpler
	  file-based API.

	  It is, in theory, a good memory allocator for low-memory devices,
	  because it can discard shared memory units when under memory pressure.


config ANDROID_TIMED_OUTPUT
	bool "Timed output class driver"
	default y
	help
	  Android timed_output class (/sys/class/timed_output), used by the
	  vibrator HAL.

config ANDROID_TIMED_GPIO
	tristate "Rockchip GPIO vibrator (rk-vibrator-gpio)"
	depends on GPIOLIB || COMPILE_TEST
	depends on ANDROID_TIMED_OUTPUT
	default n
	help
	  GPIO vibrator registered as the timed_output device "vibrator"
	  (rk_timed_gpio.c), as built in the RG DS stock kernel.

endmenu
```
