// SPDX-License-Identifier: (GPL-2.0+ OR MIT)
/*
 * Anbernic RG DS (RK3566), reconstructed from the stock Android 14 V1.21 DTB.
 * Regenerate or check with scripts/rgds/dts/ (see README.md there).
 */

/dts-v1/;

#include <dt-bindings/gpio/gpio.h>
#include <dt-bindings/interrupt-controller/arm-gic.h>
#include <dt-bindings/interrupt-controller/irq.h>
#include <dt-bindings/pinctrl/rockchip.h>
#include "rk3568.dtsi"
#include "rk3568-android.dtsi"
#include <dt-bindings/clock/rk3568-cru.h>

/ {
	compatible = "rockchip,rk3566-rk817-tablet", "rockchip,rk3566";
	model = "Anbernic RG DS (rk3568)";

	backlight: backlight {
		compatible = "pwm-backlight";
		pwms = <&pwm12 0 25000 0>;
		brightness-levels = <0 3 4 5 7 9 12 15 18 20 22 24 25 26 26 27 27 28 28 29 29 30 30 31 31 32 32 33 33 34 34 35 35 36 36 37 37 38 38 39 40 41 42 43 44 45 46 47 48 49 50 50 51 52 53 54 55 55 56 57 58 59 60 61 62 63 64 64 65 65 66 67 68 69 70 71 71 72 73 74 75 76 77 78 79 79 80 81 82 83 84 85 86 86 87 88 89 90 91 92 93 94 94 95 96 97 98 99 100 101 101 102 103 104 105 106 107 107 108 109 110 111 112 113 114 115 115 116 117 118 119 120 121 122 123 123 124 125 126 127 128 129 130 130 131 132 133 134 135 136 136 137 138 139 140 141 142 143 143 144 145 146 147 147 148 149 150 151 152 153 154 155 156 156 157 158 159 157 158 159 160 161 162 162 163 164 165 166 167 168 169 169 170 171 172 173 174 175 175 176 177 178 179 180 181 182 182 183 184 185 186 187 188 189 190 190 191 192 193 194 195 196 197 197 198 199 200 201 202 203 204 204 205 206 207 208 209 209 210 211 212 213 213 214 214 215 215 216 216 217 217 218 218 219 219 220>;
		default-brightness-level = <200>;
	};

	backlight1: backlight1 {
		compatible = "pwm-backlight";
		pwms = <&pwm13 0 25000 0>;
		brightness-levels = <0 3 4 5 7 9 12 15 18 20 22 24 25 26 26 27 27 28 28 29 29 30 30 31 31 32 32 33 33 34 34 35 35 36 36 37 37 38 38 39 40 41 42 43 44 45 46 47 48 49 50 50 51 52 53 54 55 55 56 57 58 59 60 61 62 63 64 64 65 65 66 67 68 69 70 71 71 72 73 74 75 76 77 78 79 79 80 81 82 83 84 85 86 86 87 88 89 90 91 92 93 94 94 95 96 97 98 99 100 101 101 102 103 104 105 106 107 107 108 109 110 111 112 113 114 115 115 116 117 118 119 120 121 122 123 123 124 125 126 127 128 129 130 130 131 132 133 134 135 136 136 137 138 139 140 141 142 143 143 144 145 146 147 147 148 149 150 151 152 153 154 155 156 156 157 158 159 157 158 159 160 161 162 162 163 164 165 166 167 168 169 169 170 171 172 173 174 175 175 176 177 178 179 180 181 182 182 183 184 185 186 187 188 189 190 190 191 192 193 194 195 196 197 197 198 199 200 201 202 203 204 204 205 206 207 208 209 209 210 211 212 213 213 214 214 215 215 216 216 217 217 218 218 219 219 220>;
		default-brightness-level = <200>;
	};

	mipi_dsi0_power: mipi-dsi0-power-regulator {
		compatible = "regulator-fixed";
		enable-active-high;
		gpio = <&gpio0 RK_PD3 GPIO_ACTIVE_HIGH>;
		pinctrl-names = "default";
		pinctrl-0 = <&mipi_dsi0_pwr_en>;
		regulator-name = "mipi_dsi0_power";
		regulator-always-on;
		status = "disabled";
	};

	mipi_dsi1_power: mipi-dsi1-power-regulator {
		compatible = "regulator-fixed";
		enable-active-high;
		gpio = <&gpio0 RK_PD4 GPIO_ACTIVE_HIGH>;
		pinctrl-names = "default";
		pinctrl-0 = <&mipi_dsi1_pwr_en>;
		regulator-name = "mipi_dsi1_power";
		regulator-always-on;
		status = "disabled";
	};

	gpio_backlight: gpio-backlight {
		compatible = "gpio-leds";
		pinctrl-names = "default";
		pinctrl-0 = <&mipi_dsi0_pwr_en &mipi_dsi1_pwr_en>;
		backlight_0: led@5 {
			gpios = <&gpio4 RK_PA4 GPIO_ACTIVE_HIGH>;
			label = "backlight_0_power";
			default-state = "on";
		};
		backlight_1: led@6 {
			gpios = <&gpio4 RK_PA3 GPIO_ACTIVE_HIGH>;
			label = "backlight_1_power";
			default-state = "off";
		};
	};

	adc_keys: adc-keys {
		compatible = "adc-keys";
		io-channels = <&saradc 0>;
		io-channel-names = "buttons";
		keyup-threshold-microvolt = <1800000>;
		poll-interval = <100>;
		vol-up-key {
			label = "home";
			linux,code = <0x9e>;
			press-threshold-microvolt = <1750>;
		};
	};

	keys: gpio-keys {
		compatible = "gpio-keys";
		pinctrl-names = "default";
		pinctrl-0 = <&pwr_key &gpio_hall>;
		vol-up-key {
			gpios = <&gpio3 RK_PA2 GPIO_ACTIVE_LOW>;
			linux,code = <0x72>;
			label = "volume up";
		};
		vol-down-key {
			gpios = <&gpio3 RK_PA1 GPIO_ACTIVE_LOW>;
			linux,code = <0x73>;
			label = "volume down";
		};
		hall-key0 {
			wakeup-source;
			gpios = <&gpio0 RK_PC3 GPIO_ACTIVE_LOW>;
			linux,code = <0x58>;
			label = "HALL status";
		};
	};

	joypad: singleadc-joypad {
		compatible = "singleadc-joypad";
		joypad-name = "retrogame_joypad";
		joypad-product = <4353>;
		joypad-revision = <256>;
		status = "okay";
		hw_pcb_info = <2>;
		pinctrl-names = "default";
		pinctrl-0 = <&btn_pins>;
		io-channel-names = "amux_adc";
		io-channels = <&saradc 3>;
		amux-count = <6>;
		amux-a-gpios = <&gpio3 RK_PC2 GPIO_ACTIVE_LOW>;
		amux-b-gpios = <&gpio3 RK_PC3 GPIO_ACTIVE_LOW>;
		amux-en-gpios = <&gpio3 RK_PC1 GPIO_ACTIVE_LOW>;
		button-adc-scale = <1>;
		button-adc-deadzone = <640>;
		button-adc-fuzz = <160>;
		button-adc-flat = <32>;
		abs_x-p-tuning = <250>;
		abs_x-n-tuning = <250>;
		abs_y-p-tuning = <250>;
		abs_y-n-tuning = <250>;
		abs_rx-p-tuning = <250>;
		abs_rx-n-tuning = <250>;
		abs_ry-p-tuning = <250>;
		abs_ry-n-tuning = <250>;
		poll-interval = <5>;
		sw1 {
			gpios = <&gpio2 RK_PD4 GPIO_ACTIVE_LOW>;
			label = "GPIO DPAD-UP";
			linux,input-type = <3>;
			linux,code = <0x11>;
			linux,abs-value = <2>;
		};
		sw2 {
			gpios = <&gpio2 RK_PD5 GPIO_ACTIVE_LOW>;
			label = "GPIO DPAD-DOWN";
			linux,input-type = <3>;
			linux,code = <0x11>;
			linux,abs-value = <1>;
		};
		sw3 {
			gpios = <&gpio2 RK_PD7 GPIO_ACTIVE_LOW>;
			label = "GPIO DPAD-LEFT";
			linux,input-type = <3>;
			linux,code = <0x10>;
			linux,abs-value = <2>;
		};
		sw4 {
			gpios = <&gpio2 RK_PD6 GPIO_ACTIVE_LOW>;
			label = "GPIO DPAD-RIGHT";
			linux,input-type = <3>;
			linux,code = <0x10>;
			linux,abs-value = <1>;
		};
		sw5 {
			gpios = <&gpio3 RK_PB0 GPIO_ACTIVE_LOW>;
			label = "GPIO KEY BTN-A";
			linux,code = <0x134>;
		};
		sw6 {
			gpios = <&gpio3 RK_PC0 GPIO_ACTIVE_LOW>;
			label = "GPIO BTN-B";
			linux,code = <0x131>;
		};
		sw7 {
			gpios = <&gpio3 RK_PA7 GPIO_ACTIVE_LOW>;
			label = "GPIO BTN-X";
			linux,code = <0x133>;
		};
		sw8 {
			gpios = <&gpio3 RK_PB7 GPIO_ACTIVE_LOW>;
			label = "GPIO BTN-Y";
			linux,code = <0x130>;
		};
		sw9 {
			gpios = <&gpio3 RK_PB2 GPIO_ACTIVE_LOW>;
			label = "GPIO BTN_SELECT";
			linux,code = <0x13a>;
		};
		sw10 {
			gpios = <&gpio3 RK_PB1 GPIO_ACTIVE_LOW>;
			label = "GPIO BTN_START";
			linux,code = <0x13b>;
		};
		sw12 {
			gpios = <&gpio3 RK_PA3 GPIO_ACTIVE_LOW>;
			label = "GPIO BTN_TL";
			linux,code = <0x136>;
		};
		sw13 {
			gpios = <&gpio3 RK_PA5 GPIO_ACTIVE_LOW>;
			label = "GPIO BTN_TR";
			linux,code = <0x137>;
		};
		sw14 {
			gpios = <&gpio3 RK_PA4 GPIO_ACTIVE_LOW>;
			label = "GPIO BTN_TL2";
			linux,code = <0x138>;
		};
		sw15 {
			gpios = <&gpio3 RK_PA6 GPIO_ACTIVE_LOW>;
			label = "GPIO BTN_TR2";
			linux,code = <0x139>;
		};
		sw16 {
			gpios = <&gpio2 RK_PD3 GPIO_ACTIVE_LOW>;
			label = "GPIO BTN_THUMBR";
			linux,code = <0x13e>;
		};
		sw17 {
			gpios = <&gpio2 RK_PD2 GPIO_ACTIVE_LOW>;
			label = "GPIO BTN_THUMBL";
			linux,code = <0x13d>;
		};
		sw18 {
			gpios = <&gpio3 RK_PA0 GPIO_ACTIVE_LOW>;
			label = "GPIO HALL";
			linux,code = <0x43>;
		};
		sw19 {
			gpios = <&gpio2 RK_PD1 GPIO_ACTIVE_LOW>;
			label = "GPIO RG_KEY";
			linux,code = <0x44>;
		};
	};

	leds: gpio-leds {
		compatible = "gpio-leds";
		pinctrl-names = "default";
		pinctrl-0 = <&leds_gpio>;
		led@1 {
			gpios = <&gpio0 RK_PC4 GPIO_ACTIVE_HIGH>;
			label = "battery_full";
			default-state = "off";
		};
		led@2 {
			gpios = <&gpio0 RK_PC5 GPIO_ACTIVE_HIGH>;
			label = "battery_charging";
			default-state = "off";
			retain-state-suspended;
		};
		led@3 {
			gpios = <&gpio0 RK_PC6 GPIO_ACTIVE_HIGH>;
			label = "low_power";
			default-state = "off";
		};
		led@4 {
			gpios = <&gpio0 RK_PA0 GPIO_ACTIVE_HIGH>;
			label = "wifi_reg";
			default-state = "on";
			retain-state-suspended;
		};
	};

	charge-animation {
		compatible = "rockchip,uboot-charge";
		rockchip,uboot-charge-on = <0>;
		rockchip,android-charge-on = <1>;
		rockchip,uboot-low-power-voltage = <3600>;
		rockchip,screen-on-voltage = <3600>;
		rockchip,uboot-exit-charge-level = <2>;
		rockchip,uboot-exit-charge-voltage = <3600>;
		rockchip,uboot-exit-charge-auto = <0>;
		status = "okay";
	};

	vccsys: vccsys {
		compatible = "regulator-fixed";
		regulator-name = "vcc3v8_sys";
		regulator-always-on;
		regulator-boot-on;
		regulator-min-microvolt = <3800000>;
		regulator-max-microvolt = <3800000>;
	};

	rk817-sound {
		compatible = "rockchip,multicodecs-card";
		rockchip,card-name = "rockchip-rk817";
		hp-det-gpio = <&gpio4 RK_PC2 GPIO_ACTIVE_HIGH>;
		io-channels = <&saradc 2>;
		io-channel-names = "adc-detect";
		keyup-threshold-microvolt = <1800000>;
		poll-interval = <100>;
		rockchip,format = "i2s";
		rockchip,mclk-fs = <256>;
		rockchip,cpu = <&i2s1_8ch>;
		rockchip,codec = <&rk817_codec>;
		pinctrl-names = "default";
		pinctrl-0 = <&hp_det>;
		play-pause-key {
			label = "playpause";
			linux,code = <0xa4>;
			press-threshold-microvolt = <2000>;
		};
	};

	vibrator {
		compatible = "rk-vibrator-gpio";
		vibrator-gpio = <&gpio3 RK_PC4 GPIO_ACTIVE_HIGH>;
		status = "okay";
	};

	sdio_pwrseq: sdio-pwrseq {
		compatible = "mmc-pwrseq-simple";
		pinctrl-names = "default";
		pinctrl-0 = <&wifi_enable_h>;
		post-power-on-delay-ms = <200>;
		reset-gpios = <&gpio4 RK_PA2 GPIO_ACTIVE_LOW>;
	};

	vcc_sd: vcc-sd {
		compatible = "regulator-gpio";
		enable-active-low;
		enable-gpio = <&gpio0 RK_PA5 GPIO_ACTIVE_LOW>;
		regulator-min-microvolt = <3300000>;
		regulator-max-microvolt = <3300000>;
		pinctrl-names = "default";
		pinctrl-0 = <&vcc_sd_h>;
		regulator-name = "vcc_sd";
		states = <3300000 0 3300000 1>;
	};

	wireless-wlan {
		compatible = "wlan-platdata";
		rockchip,grf = <&grf>;
		wifi_chip_type = "ap6330";
		pinctrl-names = "default";
		pinctrl-0 = <&wifi_host_wake_irq>;
		WIFI,host_wake_irq = <&gpio4 RK_PA1 GPIO_ACTIVE_HIGH>;
		keep_wifi_power_on;
		status = "okay";
	};

	wireless-bluetooth {
		compatible = "bluetooth-platdata";
		clocks = <&rk817 1>;
		clock-names = "ext_clock";
		uart_rts_gpios = <&gpio2 RK_PB5 GPIO_ACTIVE_LOW>;
		pinctrl-names = "default", "rts_gpio";
		pinctrl-0 = <&uart1m1_rtsn>;
		pinctrl-1 = <&uart1_gpios>;
		BT,reset_gpio = <&gpio0 RK_PD5 GPIO_ACTIVE_HIGH>;
		BT,wake_gpio = <&gpio0 RK_PD3 GPIO_ACTIVE_HIGH>;
		BT,wake_host_irq = <&gpio0 RK_PD4 GPIO_ACTIVE_HIGH>;
		status = "okay";
	};

	vcc5v0_usb: vcc5v0-usb {
		compatible = "regulator-fixed";
		regulator-name = "vcc5v0_usb";
		regulator-always-on;
		regulator-boot-on;
		regulator-min-microvolt = <5000000>;
		regulator-max-microvolt = <5000000>;
	};

	vcc5v0_otg: vcc5v0-otg-regulator {
		compatible = "regulator-fixed";
		regulator-name = "vcc5v0_otg";
		regulator-min-microvolt = <5000000>;
		regulator-max-microvolt = <5000000>;
		enable-active-high;
		vin-supply = <&vcc5v0_usb>;
	};

	aliases {
		csi2dphy0 = "/csi2-dphy0";
		csi2dphy1 = "/csi2-dphy1";
		csi2dphy2 = "/csi2-dphy2";
		dsi0 = "/dsi@fe060000";
		dsi1 = "/dsi@fe070000";
		ethernet1 = "/ethernet@fe010000";
		gpio0 = "/pinctrl/gpio@fdd60000";
		gpio1 = "/pinctrl/gpio@fe740000";
		gpio2 = "/pinctrl/gpio@fe750000";
		gpio3 = "/pinctrl/gpio@fe760000";
		gpio4 = "/pinctrl/gpio@fe770000";
		i2c0 = "/i2c@fdd40000";
		i2c1 = "/i2c@fe5a0000";
		i2c2 = "/i2c@fe5b0000";
		i2c3 = "/i2c@fe5c0000";
		i2c4 = "/i2c@fe5d0000";
		i2c5 = "/i2c@fe5e0000";
		mmc0 = "/dwmmc@fe2b0000";
		mmc1 = "/dwmmc@fe2c0000";
		mmc2 = "/sdhci@fe310000";
		mmc3 = "/dwmmc@fe000000";
		serial0 = "/serial@fdd50000";
		serial1 = "/serial@fe650000";
		serial2 = "/serial@fe660000";
		serial3 = "/serial@fe670000";
		serial4 = "/serial@fe680000";
		serial5 = "/serial@fe690000";
		serial6 = "/serial@fe6a0000";
		serial7 = "/serial@fe6b0000";
		serial8 = "/serial@fe6c0000";
		serial9 = "/serial@fe6d0000";
		spi0 = "/spi@fe610000";
		spi1 = "/spi@fe620000";
		spi2 = "/spi@fe630000";
		spi3 = "/spi@fe640000";
		ethernet0 = "/ethernet@fe2a0000";
		lvds0 = "/syscon@fdc60000/lvds";
		lvds1 = "/syscon@fdc60000/lvds1";
	};

	cpuinfo {
		nvmem-cells = <&otp_id &otp_cpu_version &cpu_code &specification_serial_number &remark_spec_serial_number>;
	};

	pvtm@fde00000 {
		pvtm@0 {
			clocks = <&cru CLK_CORE_PVTM>, <&cru PCLK_CORE_PVTM>;
			resets = <&cru SRST_CORE_PVTM>, <&cru SRST_P_CORE_PVTM>;
		};
	};

	pvtm@fde80000 {
		pvtm@1 {
			clocks = <&cru CLK_GPU_PVTM>, <&cru PCLK_GPU_PVTM>;
			resets = <&cru SRST_GPU_PVTM>, <&cru SRST_P_GPU_PVTM>;
		};
	};

	pvtm@fde90000 {
		pvtm@2 {
			clocks = <&cru CLK_NPU_PVTM>, <&cru PCLK_NPU_PVTM>, <&cru HCLK_NPU_PRE>;
			resets = <&cru SRST_NPU_PVTM>, <&cru SRST_P_NPU_PVTM>;
		};
	};

	fiq-debugger {
		pinctrl-0 = <&uart2m0_xfer>;
	};
};

&acodec_pins {
	rockchip,pins = <1 RK_PB1 5 &pcfg_pull_none>,
			<1 RK_PA1 5 &pcfg_pull_none>,
			<1 RK_PA0 5 &pcfg_pull_none>,
			<1 RK_PA7 5 &pcfg_pull_none>,
			<1 RK_PB0 5 &pcfg_pull_none>,
			<1 RK_PA3 5 &pcfg_pull_none>,
			<1 RK_PA5 5 &pcfg_pull_none>;
};

&arm_pmu {
	interrupt-affinity = <&cpu0 &cpu1 &cpu2 &cpu3>;
};

&audiopwm_lout {
	rockchip,pins = <1 RK_PA0 4 &pcfg_pull_none>;
};

&audiopwm_loutn {
	rockchip,pins = <1 RK_PA1 6 &pcfg_pull_none>;
};

&audiopwm_loutp {
	rockchip,pins = <1 RK_PA0 6 &pcfg_pull_none>;
};

&audiopwm_rout {
	rockchip,pins = <1 RK_PA1 4 &pcfg_pull_none>;
};

&audiopwm_routn {
	rockchip,pins = <1 RK_PA7 4 &pcfg_pull_none>;
};

&audiopwm_routp {
	rockchip,pins = <1 RK_PA6 4 &pcfg_pull_none>;
};

&audpwm {
	clocks = <&cru SCLK_AUDPWM>, <&cru HCLK_AUDPWM>;
	dmas = <&dmac1 8>;
};

&bt1120_pins {
	rockchip,pins = <3 RK_PA6 2 &pcfg_pull_none>,
			<3 RK_PA1 2 &pcfg_pull_none>,
			<3 RK_PA2 2 &pcfg_pull_none>,
			<3 RK_PA3 2 &pcfg_pull_none>,
			<3 RK_PA4 2 &pcfg_pull_none>,
			<3 RK_PA5 2 &pcfg_pull_none>,
			<3 RK_PA7 2 &pcfg_pull_none>,
			<3 RK_PB0 2 &pcfg_pull_none>,
			<3 RK_PB1 2 &pcfg_pull_none>,
			<3 RK_PB2 2 &pcfg_pull_none>,
			<3 RK_PB3 2 &pcfg_pull_none>,
			<3 RK_PB4 2 &pcfg_pull_none>,
			<3 RK_PB5 2 &pcfg_pull_none>,
			<3 RK_PB6 2 &pcfg_pull_none>,
			<3 RK_PC1 2 &pcfg_pull_none>,
			<3 RK_PC2 2 &pcfg_pull_none>,
			<3 RK_PC3 2 &pcfg_pull_none>;
};

&bt656m0_pins {
	rockchip,pins = <3 RK_PA0 2 &pcfg_pull_none>,
			<2 RK_PD0 2 &pcfg_pull_none>,
			<2 RK_PD1 2 &pcfg_pull_none>,
			<2 RK_PD2 2 &pcfg_pull_none>,
			<2 RK_PD3 2 &pcfg_pull_none>,
			<2 RK_PD4 2 &pcfg_pull_none>,
			<2 RK_PD5 2 &pcfg_pull_none>,
			<2 RK_PD6 2 &pcfg_pull_none>,
			<2 RK_PD7 2 &pcfg_pull_none>;
};

&bt656m1_pins {
	rockchip,pins = <4 RK_PB4 5 &pcfg_pull_none>,
			<3 RK_PC6 5 &pcfg_pull_none>,
			<3 RK_PC7 5 &pcfg_pull_none>,
			<3 RK_PD0 5 &pcfg_pull_none>,
			<3 RK_PD1 5 &pcfg_pull_none>,
			<3 RK_PD2 5 &pcfg_pull_none>,
			<3 RK_PD3 5 &pcfg_pull_none>,
			<3 RK_PD4 5 &pcfg_pull_none>,
			<3 RK_PD5 5 &pcfg_pull_none>;
};

&bus_npu {
	operating-points-v2 = <&bus_npu_opp_table>;
	status = "okay";
	bus-supply = <&vdd_logic>;
	pvtm-supply = <&vdd_cpu>;
};

&bus_npu_opp_table {
	nvmem-cells = <&core_pvtm>;
};

&cam_clkout0 {
	rockchip,pins = <4 RK_PA7 1 &pcfg_pull_none>;
};

&cam_clkout1 {
	rockchip,pins = <4 RK_PB0 1 &pcfg_pull_none>;
};

&can0 {
	clocks = <&cru CLK_CAN0>, <&cru PCLK_CAN0>;
	resets = <&cru SRST_CAN0>, <&cru SRST_P_CAN0>;
};

&can0m0_pins {
	rockchip,pins = <0 RK_PB4 2 &pcfg_pull_none>,
			<0 RK_PB3 2 &pcfg_pull_none>;
};

&can0m1_pins {
	rockchip,pins = <2 RK_PA2 4 &pcfg_pull_none>,
			<2 RK_PA1 4 &pcfg_pull_none>;
};

&can1 {
	clocks = <&cru CLK_CAN1>, <&cru PCLK_CAN1>;
	resets = <&cru SRST_CAN1>, <&cru SRST_P_CAN1>;
};

&can1m0_pins {
	rockchip,pins = <1 RK_PA0 3 &pcfg_pull_none>,
			<1 RK_PA1 3 &pcfg_pull_none>;
};

&can1m1_pins {
	rockchip,pins = <4 RK_PC2 3 &pcfg_pull_none>,
			<4 RK_PC3 3 &pcfg_pull_none>;
};

&can2 {
	clocks = <&cru CLK_CAN2>, <&cru PCLK_CAN2>;
	resets = <&cru SRST_CAN2>, <&cru SRST_P_CAN2>;
};

&can2m0_pins {
	rockchip,pins = <4 RK_PB4 3 &pcfg_pull_none>,
			<4 RK_PB5 3 &pcfg_pull_none>;
};

&can2m1_pins {
	rockchip,pins = <2 RK_PB1 4 &pcfg_pull_none>,
			<2 RK_PB2 4 &pcfg_pull_none>;
};

&cif_clk {
	rockchip,pins = <4 RK_PC0 1 &pcfg_pull_none>;
};

&cif_dvp_bus16 {
	rockchip,pins = <3 RK_PD6 1 &pcfg_pull_none>,
			<3 RK_PD7 1 &pcfg_pull_none>,
			<4 RK_PA0 1 &pcfg_pull_none>,
			<4 RK_PA1 1 &pcfg_pull_none>,
			<4 RK_PA2 1 &pcfg_pull_none>,
			<4 RK_PA3 1 &pcfg_pull_none>,
			<4 RK_PA4 1 &pcfg_pull_none>,
			<4 RK_PA5 1 &pcfg_pull_none>;
};

&cif_dvp_bus8 {
	rockchip,pins = <3 RK_PC6 1 &pcfg_pull_none>,
			<3 RK_PC7 1 &pcfg_pull_none>,
			<3 RK_PD0 1 &pcfg_pull_none>,
			<3 RK_PD1 1 &pcfg_pull_none>,
			<3 RK_PD2 1 &pcfg_pull_none>,
			<3 RK_PD3 1 &pcfg_pull_none>,
			<3 RK_PD4 1 &pcfg_pull_none>,
			<3 RK_PD5 1 &pcfg_pull_none>;
};

&cif_dvp_clk {
	rockchip,pins = <4 RK_PC1 1 &pcfg_pull_none>,
			<4 RK_PB6 1 &pcfg_pull_none>,
			<4 RK_PB7 1 &pcfg_pull_none>;
};

&clk32k_in {
	rockchip,pins = <0 RK_PB0 1 &pcfg_pull_none>;
};

&clk32k_out0 {
	rockchip,pins = <0 RK_PB0 2 &pcfg_pull_none>;
};

&clk32k_out1 {
	rockchip,pins = <2 RK_PC6 1 &pcfg_pull_none>;
};

&combphy0_us {
	clocks = <&pmucru CLK_PCIEPHY0_REF>, <&cru PCLK_PIPEPHY0>, <&cru PCLK_PIPE>;
	assigned-clocks = <&pmucru CLK_PCIEPHY0_REF>;
	resets = <&cru SRST_P_PIPEPHY0>, <&cru SRST_PIPEPHY0>;
	rockchip,pipe-grf = <&pipegrf>;
	rockchip,pipe-phy-grf = <&pipe_phy_grf0>;
};

&combphy1_usq {
	clocks = <&pmucru CLK_PCIEPHY1_REF>, <&cru PCLK_PIPEPHY1>, <&cru PCLK_PIPE>;
	assigned-clocks = <&pmucru CLK_PCIEPHY1_REF>;
	resets = <&cru SRST_P_PIPEPHY1>, <&cru SRST_PIPEPHY1>;
	rockchip,pipe-grf = <&pipegrf>;
	rockchip,pipe-phy-grf = <&pipe_phy_grf1>;
};

&combphy2_psq {
	clocks = <&pmucru CLK_PCIEPHY2_REF>, <&cru PCLK_PIPEPHY2>, <&cru PCLK_PIPE>;
	assigned-clocks = <&pmucru CLK_PCIEPHY2_REF>;
	resets = <&cru SRST_P_PIPEPHY2>, <&cru SRST_PIPEPHY2>;
	rockchip,pipe-grf = <&pipegrf>;
	rockchip,pipe-phy-grf = <&pipe_phy_grf2>;
};

&cpu0 {
	cpu-supply = <&vdd_cpu>;
};

&cpu0_opp_table {
	nvmem-cells = <&cpu_leakage &core_pvtm &mbist_vmin &cpu_opp_info &specification_serial_number &remark_spec_serial_number>;
};

&cpu_pins {
	rockchip,pins = <0 RK_PB7 2 &pcfg_pull_none>;
};

&cru {
	rockchip,grf = <&grf>;
	assigned-clocks = <&pmucru CLK_RTC_32K>, <&cru ACLK_RKVDEC_PRE>, <&cru CLK_RKVDEC_CORE>, <&pmucru PLL_PPLL>, <&pmucru PCLK_PMU>, <&cru PLL_CPLL>, <&cru CPLL_500M>, <&cru CPLL_333M>, <&cru CPLL_250M>, <&cru CPLL_125M>, <&cru CPLL_100M>, <&cru CPLL_62P5M>, <&cru CPLL_50M>, <&cru CPLL_25M>, <&cru PLL_GPLL>, <&cru ACLK_BUS>, <&cru PCLK_BUS>, <&cru ACLK_TOP_HIGH>, <&cru ACLK_TOP_LOW>, <&cru HCLK_TOP>, <&cru PCLK_TOP>, <&cru ACLK_PERIMID>, <&cru HCLK_PERIMID>, <&cru PLL_NPLL>, <&cru ACLK_PIPE>, <&cru PCLK_PIPE>, <&cru CLK_I2S0_8CH_TX_SRC>, <&cru CLK_I2S0_8CH_RX_SRC>, <&cru CLK_I2S1_8CH_TX_SRC>, <&cru CLK_I2S1_8CH_RX_SRC>, <&cru CLK_I2S2_2CH_SRC>, <&cru CLK_I2S2_2CH_SRC>, <&cru CLK_I2S3_2CH_RX_SRC>, <&cru CLK_I2S3_2CH_TX_SRC>, <&cru MCLK_SPDIF_8CH_SRC>, <&cru ACLK_VOP>;
	assigned-clock-parents = <&pmucru CLK_RTC32K_FRAC>, <&cru PLL_GPLL>, <&cru PLL_GPLL>;
};

&crypto {
	clocks = <&cru ACLK_CRYPTO_NS>, <&cru HCLK_CRYPTO_NS>, <&cru CLK_CRYPTO_NS_CORE>, <&cru CLK_CRYPTO_NS_PKA>;
	assigned-clocks = <&cru CLK_CRYPTO_NS_CORE>;
	resets = <&cru SRST_CRYPTO_NS_CORE>;
};

&csi2_dphy0 {
	rockchip,hw = <&csi2_dphy_hw>;
};

&csi2_dphy1 {
	rockchip,hw = <&csi2_dphy_hw>;
};

&csi2_dphy2 {
	rockchip,hw = <&csi2_dphy_hw>;
};

&csi2_dphy_hw {
	clocks = <&cru PCLK_MIPICSIPHY>;
	rockchip,grf = <&grf>;
};

&dfi {
	rockchip,pmugrf = <&pmugrf>;
	status = "okay";
};

&dig_acodec {
	clocks = <&cru CLK_ACDCDIG_ADC>, <&cru CLK_ACDCDIG_DAC>, <&cru CLK_ACDCDIG_I2C>, <&cru HCLK_ACDCDIG>;
	pinctrl-0 = <&acodec_pins>;
	resets = <&cru SRST_ACDCDIG>;
	rockchip,grf = <&grf>;
};

&display_subsystem {
	memory-region = <&drm_logo &drm_cubic_lut>;
	ports = <&vop_out>;
	devfreq = <&dmc>;
};

&dmac0 {
	clocks = <&cru ACLK_BUS>;
};

&dmac1 {
	clocks = <&cru ACLK_BUS>;
};

&dmc {
	devfreq-events = <&dfi &nocp_cpu>;
	operating-points-v2 = <&dmc_opp_table>;
	status = "okay";
	center-supply = <&vdd_logic>;
};

&dmc_fsp {
	ddr3_params = <0xaf>;
	ddr4_params = <0xb0>;
	lpddr3_params = <0xb1>;
	lpddr4_params = <0xb2>;
	lpddr4x_params = <0xb3>;
};

&dmc_opp_table {
	nvmem-cells = <&log_leakage &core_pvtm &mbist_vmin &dmc_opp_info &specification_serial_number &remark_spec_serial_number>;
};

&dsi0 {
	clocks = <&cru PCLK_DSITX_0>, <&cru HCLK_VO>;
	phys = <&video_phy0>;
	power-domains = <&power 9>;
	resets = <&cru SRST_P_DSITX_0>;
	rockchip,grf = <&grf>;
	status = "okay";

	dsi0_panel: panel@0 {
		compatible = "aoly,sl008pa21y1285-b00", "simple-panel-dsi";
		status = "okay";
		reg = <0x0>;
		num = <0>;
		backlight = <&backlight>;
		enable-gpios = <&gpio0 RK_PC7 GPIO_ACTIVE_HIGH>;
		enable1-gpios = <&gpio0 RK_PB0 GPIO_ACTIVE_HIGH>;
		reset-gpios = <&gpio0 RK_PB3 GPIO_ACTIVE_LOW>;
		pinctrl-names = "default";
		pinctrl-0 = <&lcd_enable_gpio &lcd_rst_gpio>;
		stbyb-delay-ms = <10>;
		prepare-delay-ms = <10>;
		reset-delay-ms = <10>;
		init-delay-ms = <10>;
		enable-delay-ms = <10>;
		disable-delay-ms = <10>;
		unprepare-delay-ms = <10>;
		width-mm = <229>;
		height-mm = <143>;
		dsi,flags = <2051>;
		dsi,format = <0>;
		dsi,lanes = <4>;
		panel-init-sequence = [150002e000150002e193150002e265150002e3f81500028003150002e0011500020000150002016a1500020310150002046a1500020c74150002170015000218bf15000219011500021a001500021bbf1500021c0115000224fe1500023709150002380215000239081500023a1f1500023cf71500023dff1500023eff1500023fff1500024003150002413c15000242ff150002430a150002441115000245781500025502150002576d150002580a150002590a1500025a1f1500025b1f1500025d7f1500025e561500025f431500026034150002612f15000262201500026322150002640c150002652415000266241500026725150002684315000269331500026a3a1500026b2d1500026c281500026d1b1500026e0b1500026f00150002707f150002715615000272431500027334150002742f15000275201500027622150002770c150002782415000279241500027a251500027b431500027c331500027d3a1500027e2d1500027f28150002801b150002810b1500028200150002e002150002005f150002015f150002025f150002035e15000204501500020540150002065f1500020757150002087715000209481500020a481500020b4a1500020c4a1500020d441500020e441500020f461500021046150002115f150002125f150002135f150002145f150002155f150002165f150002175f150002185f150002195e1500021a501500021b411500021c5f1500021d571500021e771500021f491500022049150002214b150002224b1500022345150002244515000225471500022647150002275f150002285f150002295f1500022a5f1500022b5f1500022c1f1500022d1f1500022e1e1500022f1f15000230101500023101150002321f150002331715000234171500023507150002360715000237051500023805150002390b1500023a0b1500023b091500023c091500023d1f1500023e1f1500023f1f150002401f150002411f150002421f150002431f150002441e150002451f15000246101500024700150002481f15000249171500024a171500024b061500024c061500024d041500024e041500024f0a150002500a15000251081500025208150002531f150002541f150002551f150002561f150002571f150002584015000259001500025a001500025b101500025c071500025d301500025e011500025f02150002603015000261011500026202150002630615000264e9150002654015000266021500026773150002680b15000269061500026ae91500026b0815000275da1500027600150002770115000278fc150002810815000283f41500028710150002e004150002000e15000202b315000209601500020e481500021e0015000237581500022b0f150002e005150002151d150002e0001578021100150a022900];
		panel-exit-sequence = <88080680 91750672>;
		panel-read-id-sequence = [0500020000];
		display-timings {
			native-mode = <&timing0>;
			timing0: timing0 {
				clock-frequency = <42100000>;
				hactive = <640>;
				vactive = <480>;
				hsync-len = <220>;
				hback-porch = <260>;
				hfront-porch = <260>;
				vsync-len = <2>;
				vback-porch = <16>;
				vfront-porch = <10>;
				hsync-active = <0>;
				vsync-active = <0>;
				de-active = <0>;
				pixelclk-active = <1>;
			};
		};
		ports {
			#address-cells = <1>;
			#size-cells = <0>;
			port@0 {
				reg = <0x0>;
				panel_in_dsi0: endpoint {
					remote-endpoint = <&dsi0_out_panel>;
				};
			};
		};
	};

	ports {
		port@1 {
			reg = <0x1>;
			dsi0_out_panel: endpoint {
				remote-endpoint = <&panel_in_dsi0>;
			};
		};
	};
};

&dsi0_in_vp0 {
	remote-endpoint = <&vp0_out_dsi0>;
	status = "okay";
};

&dsi0_in_vp1 {
	remote-endpoint = <&vp1_out_dsi0>;
};

&dsi1 {
	clocks = <&cru PCLK_DSITX_1>, <&cru HCLK_VO>;
	phys = <&video_phy1>;
	power-domains = <&power 9>;
	resets = <&cru SRST_P_DSITX_1>;
	rockchip,grf = <&grf>;
	status = "okay";

	dsi1_panel: panel@0 {
		status = "okay";
		compatible = "simple-panel-dsi";
		reg = <0x0>;
		backlight = <&backlight1>;
		enable-gpios = <&gpio0 RK_PC1 GPIO_ACTIVE_HIGH>;
		enable1-gpios = <&gpio0 RK_PC2 GPIO_ACTIVE_HIGH>;
		reset-gpios = <&gpio0 RK_PB4 GPIO_ACTIVE_LOW>;
		pinctrl-names = "default";
		pinctrl-0 = <&lcd1_enable_gpio &lcd1_rst_gpio>;
		stbyb-delay-ms = <10>;
		prepare-delay-ms = <10>;
		reset-delay-ms = <10>;
		init-delay-ms = <10>;
		enable-delay-ms = <10>;
		disable-delay-ms = <10>;
		unprepare-delay-ms = <10>;
		width-mm = <229>;
		height-mm = <143>;
		dsi,flags = <2051>;
		dsi,format = <0>;
		dsi,lanes = <4>;
		panel-init-sequence = [150002e000150002e193150002e265150002e3f81500028003150002e0011500020000150002016a1500020310150002046a1500020c74150002170015000218bf15000219011500021a001500021bbf1500021c0115000224fe1500023705150002380215000239081500023a1f1500023cf71500023dff1500023eff1500023fff1500024003150002413c15000242ff150002430a150002441115000245781500025502150002576d150002580a150002590a1500025a1f1500025b1f1500025d7f1500025e561500025f431500026034150002612f15000262201500026322150002640c150002652415000266241500026725150002684315000269331500026a3a1500026b2d1500026c281500026d1b1500026e0b1500026f00150002707f150002715615000272431500027334150002742f15000275201500027622150002770c150002782415000279241500027a251500027b431500027c331500027d3a1500027e2d1500027f28150002801b150002810b1500028200150002e002150002005f150002015f150002025f150002035e15000204501500020540150002065f1500020757150002087715000209481500020a481500020b4a1500020c4a1500020d441500020e441500020f461500021046150002115f150002125f150002135f150002145f150002155f150002165f150002175f150002185f150002195e1500021a501500021b411500021c5f1500021d571500021e771500021f491500022049150002214b150002224b1500022345150002244515000225471500022647150002275f150002285f150002295f1500022a5f1500022b5f1500022c1f1500022d1f1500022e1e1500022f1f15000230101500023101150002321f150002331715000234171500023507150002360715000237051500023805150002390b1500023a0b1500023b091500023c091500023d1f1500023e1f1500023f1f150002401f150002411f150002421f150002431f150002441e150002451f15000246101500024700150002481f15000249171500024a171500024b061500024c061500024d041500024e041500024f0a150002500a15000251081500025208150002531f150002541f150002551f150002561f150002571f150002584015000259001500025a001500025b101500025c071500025d301500025e011500025f02150002603015000261011500026202150002630615000264e9150002654015000266021500026773150002680b15000269061500026ae91500026b0815000275da1500027600150002770115000278fc150002810815000283f41500028710150002e004150002000e15000202b315000209601500020e481500021e0015000237581500022b0f150002e005150002151d150002e00015000236001578021100150a022900];
		panel-exit-sequence = <88080680 91750672>;
		disp_timings: display-timings {
			native-mode = <&dsi1_timing>;
			dsi1_timing: timing {
				clock-frequency = <42100000>;
				hactive = <640>;
				vactive = <480>;
				hsync-len = <220>;
				hback-porch = <260>;
				hfront-porch = <260>;
				vsync-len = <2>;
				vback-porch = <16>;
				vfront-porch = <10>;
				hsync-active = <0>;
				vsync-active = <0>;
				de-active = <0>;
				pixelclk-active = <1>;
			};
		};
		ports {
			#address-cells = <1>;
			#size-cells = <0>;
			port@0 {
				reg = <0x0>;
				panel_in_dsi1: endpoint {
					remote-endpoint = <&dsi1_out_panel>;
				};
			};
		};
	};

	ports {
		port@1 {
			reg = <0x1>;
			dsi1_out_panel: endpoint {
				remote-endpoint = <&panel_in_dsi1>;
			};
		};
	};
};

&dsi1_in_vp0 {
	remote-endpoint = <&vp0_out_dsi1>;
};

&dsi1_in_vp1 {
	remote-endpoint = <&vp1_out_dsi1>;
	status = "okay";
};

&dsi_dphy0 {
	clocks = <&pmucru CLK_MIPIDSIPHY0_REF>, <&cru PCLK_MIPIDSIPHY0>;
	power-domains = <&power 9>;
	resets = <&cru SRST_P_MIPIDSIPHY0>;
};

&dsi_dphy1 {
	clocks = <&pmucru CLK_MIPIDSIPHY1_REF>, <&cru PCLK_MIPIDSIPHY1>;
	power-domains = <&power 9>;
	resets = <&cru SRST_P_MIPIDSIPHY1>;
};

&ebc {
	clocks = <&cru HCLK_EBC>, <&cru DCLK_EBC>;
	power-domains = <&power 10>;
	rockchip,grf = <&grf>;
	pinctrl-0 = <&ebc_pins>;
};

&ebc_extern {
	rockchip,pins = <4 RK_PA7 2 &pcfg_pull_none>,
			<4 RK_PB0 2 &pcfg_pull_none>,
			<4 RK_PB1 2 &pcfg_pull_none>,
			<4 RK_PB5 2 &pcfg_pull_none>,
			<4 RK_PB2 2 &pcfg_pull_none>;
};

&ebc_pins {
	rockchip,pins = <4 RK_PC0 2 &pcfg_pull_none>,
			<4 RK_PB3 2 &pcfg_pull_none>,
			<4 RK_PB4 2 &pcfg_pull_none>,
			<4 RK_PA6 2 &pcfg_pull_none>,
			<4 RK_PC1 2 &pcfg_pull_none>,
			<3 RK_PC6 2 &pcfg_pull_none>,
			<3 RK_PC7 2 &pcfg_pull_none>,
			<3 RK_PD0 2 &pcfg_pull_none>,
			<3 RK_PD1 2 &pcfg_pull_none>,
			<3 RK_PD2 2 &pcfg_pull_none>,
			<3 RK_PD3 2 &pcfg_pull_none>,
			<3 RK_PD4 2 &pcfg_pull_none>,
			<3 RK_PD5 2 &pcfg_pull_none>,
			<3 RK_PD6 2 &pcfg_pull_none>,
			<3 RK_PD7 2 &pcfg_pull_none>,
			<4 RK_PA0 2 &pcfg_pull_none>,
			<4 RK_PA1 2 &pcfg_pull_none>,
			<4 RK_PA2 2 &pcfg_pull_none>,
			<4 RK_PA3 2 &pcfg_pull_none>,
			<4 RK_PA4 2 &pcfg_pull_none>,
			<4 RK_PA5 2 &pcfg_pull_none>,
			<4 RK_PB6 2 &pcfg_pull_none>,
			<4 RK_PB7 2 &pcfg_pull_none>;
};

&edp {
	clocks = <&pmucru XIN_OSC0_EDPPHY_G>, <&cru PCLK_EDP_CTRL>, <&cru CLK_EDP_200M>, <&cru HCLK_VO>;
	resets = <&cru SRST_EDP_24M>, <&cru SRST_P_EDP_CTRL>;
	phys = <&edp_phy>;
	power-domains = <&power 9>;
};

&edp_in_vp0 {
	remote-endpoint = <&vp0_out_edp>;
};

&edp_in_vp1 {
	remote-endpoint = <&vp1_out_edp>;
};

&edp_phy {
	clocks = <&pmucru XIN_OSC0_EDPPHY_G>;
};

&edp_phy_grf {
	clocks = <&cru PCLK_EDPPHY_GRF>;
};

&edpdpm0_pins {
	rockchip,pins = <4 RK_PC4 1 &pcfg_pull_none>;
};

&edpdpm1_pins {
	rockchip,pins = <0 RK_PC2 2 &pcfg_pull_none>;
};

&eink {
	clocks = <&cru PCLK_EINK>, <&cru HCLK_EINK>;
};

&emmc_bus8 {
	rockchip,pins = <1 RK_PB4 1 &pcfg_pull_up_drv_level_2>,
			<1 RK_PB5 1 &pcfg_pull_up_drv_level_2>,
			<1 RK_PB6 1 &pcfg_pull_up_drv_level_2>,
			<1 RK_PB7 1 &pcfg_pull_up_drv_level_2>,
			<1 RK_PC0 1 &pcfg_pull_up_drv_level_2>,
			<1 RK_PC1 1 &pcfg_pull_up_drv_level_2>,
			<1 RK_PC2 1 &pcfg_pull_up_drv_level_2>,
			<1 RK_PC3 1 &pcfg_pull_up_drv_level_2>;
};

&emmc_clk {
	rockchip,pins = <1 RK_PC5 1 &pcfg_pull_up_drv_level_2>;
};

&emmc_cmd {
	rockchip,pins = <1 RK_PC4 1 &pcfg_pull_up_drv_level_2>;
};

&emmc_datastrobe {
	rockchip,pins = <1 RK_PC6 1 &pcfg_pull_none>;
};

&emmc_rstnout {
	rockchip,pins = <1 RK_PC7 1 &pcfg_pull_none>;
};

&eth0_pins {
	rockchip,pins = <2 RK_PC1 2 &pcfg_pull_none>;
};

&eth1m0_pins {
	rockchip,pins = <3 RK_PB0 3 &pcfg_pull_none>;
};

&eth1m1_pins {
	rockchip,pins = <4 RK_PB3 3 &pcfg_pull_none>;
};

&flash_pins {
	rockchip,pins = <1 RK_PD0 2 &pcfg_pull_none>,
			<1 RK_PC6 3 &pcfg_pull_none>,
			<1 RK_PD3 2 &pcfg_pull_none>,
			<1 RK_PD4 2 &pcfg_pull_none>,
			<1 RK_PB4 2 &pcfg_pull_none>,
			<1 RK_PB5 2 &pcfg_pull_none>,
			<1 RK_PB6 2 &pcfg_pull_none>,
			<1 RK_PB7 2 &pcfg_pull_none>,
			<1 RK_PC0 2 &pcfg_pull_none>,
			<1 RK_PC1 2 &pcfg_pull_none>,
			<1 RK_PC2 2 &pcfg_pull_none>,
			<1 RK_PC3 2 &pcfg_pull_none>,
			<1 RK_PC5 2 &pcfg_pull_none>,
			<1 RK_PD2 2 &pcfg_pull_none>,
			<1 RK_PD1 2 &pcfg_pull_none>,
			<0 RK_PA7 1 &pcfg_pull_none>,
			<1 RK_PC7 3 &pcfg_pull_none>,
			<1 RK_PC4 2 &pcfg_pull_none>;
};

&fspi_cs1 {
	rockchip,pins = <1 RK_PC6 2 &pcfg_pull_up>;
};

&fspi_pins {
	rockchip,pins = <1 RK_PD0 1 &pcfg_pull_none>,
			<1 RK_PD3 1 &pcfg_pull_none>,
			<1 RK_PD1 1 &pcfg_pull_none>,
			<1 RK_PD2 1 &pcfg_pull_none>,
			<1 RK_PC7 2 &pcfg_pull_none>,
			<1 RK_PD4 1 &pcfg_pull_none>;
};

&gmac0 {
	clocks = <&cru SCLK_GMAC0>, <&cru SCLK_GMAC0_RX_TX>, <&cru SCLK_GMAC0_RX_TX>, <&cru CLK_MAC0_REFOUT>, <&cru ACLK_GMAC0>, <&cru PCLK_GMAC0>, <&cru SCLK_GMAC0_RX_TX>, <&cru CLK_GMAC0_PTP_REF>, <&cru PCLK_XPCS>, <&cru CLK_XPCS_EEE>;
	resets = <&cru SRST_A_GMAC0>;
	rockchip,grf = <&grf>;
	snps,axi-config = <&gmac0_stmmac_axi_setup>;
	snps,mtl-rx-config = <&gmac0_mtl_rx_setup>;
	snps,mtl-tx-config = <&gmac0_mtl_tx_setup>;
};

&gmac0_clkinout {
	rockchip,pins = <2 RK_PC2 2 &pcfg_pull_none>;
};

&gmac0_miim {
	rockchip,pins = <2 RK_PC3 2 &pcfg_pull_none>,
			<2 RK_PC4 2 &pcfg_pull_none>;
};

&gmac0_rgmii_bus {
	rockchip,pins = <2 RK_PA3 2 &pcfg_pull_none>,
			<2 RK_PA4 2 &pcfg_pull_none>,
			<2 RK_PA6 2 &pcfg_pull_none_drv_level_2>,
			<2 RK_PA7 2 &pcfg_pull_none_drv_level_2>;
};

&gmac0_rgmii_bus_level3 {
	rockchip,pins = <2 RK_PA3 2 &pcfg_pull_none>,
			<2 RK_PA4 2 &pcfg_pull_none>,
			<2 RK_PA6 2 &pcfg_pull_none_drv_level_3>,
			<2 RK_PA7 2 &pcfg_pull_none_drv_level_3>;
};

&gmac0_rgmii_clk {
	rockchip,pins = <2 RK_PA5 2 &pcfg_pull_none>,
			<2 RK_PB0 2 &pcfg_pull_none_drv_level_1>;
};

&gmac0_rgmii_clk_level2 {
	rockchip,pins = <2 RK_PA5 2 &pcfg_pull_none>,
			<2 RK_PB0 2 &pcfg_pull_none_drv_level_2>;
};

&gmac0_rx_bus2 {
	rockchip,pins = <2 RK_PB6 1 &pcfg_pull_none>,
			<2 RK_PB7 2 &pcfg_pull_none>,
			<2 RK_PC0 2 &pcfg_pull_none>;
};

&gmac0_rx_er {
	rockchip,pins = <2 RK_PC5 2 &pcfg_pull_none>;
};

&gmac0_tx_bus2 {
	rockchip,pins = <2 RK_PB3 1 &pcfg_pull_none_drv_level_2>,
			<2 RK_PB4 1 &pcfg_pull_none_drv_level_2>,
			<2 RK_PB5 1 &pcfg_pull_none>;
};

&gmac0_tx_bus2_level3 {
	rockchip,pins = <2 RK_PB3 1 &pcfg_pull_none_drv_level_3>,
			<2 RK_PB4 1 &pcfg_pull_none_drv_level_3>,
			<2 RK_PB5 1 &pcfg_pull_none>;
};

&gmac1 {
	clocks = <&cru SCLK_GMAC1>, <&cru SCLK_GMAC1_RX_TX>, <&cru SCLK_GMAC1_RX_TX>, <&cru CLK_MAC1_REFOUT>, <&cru ACLK_GMAC1>, <&cru PCLK_GMAC1>, <&cru SCLK_GMAC1_RX_TX>, <&cru CLK_GMAC1_PTP_REF>, <&cru PCLK_XPCS>, <&cru CLK_XPCS_EEE>;
	resets = <&cru SRST_A_GMAC1>;
	rockchip,grf = <&grf>;
	snps,axi-config = <&gmac1_stmmac_axi_setup>;
	snps,mtl-rx-config = <&gmac1_mtl_rx_setup>;
	snps,mtl-tx-config = <&gmac1_mtl_tx_setup>;
};

&gmac1m0_clkinout {
	rockchip,pins = <3 RK_PC0 3 &pcfg_pull_none>;
};

&gmac1m0_miim {
	rockchip,pins = <3 RK_PC4 3 &pcfg_pull_none>,
			<3 RK_PC5 3 &pcfg_pull_none>;
};

&gmac1m0_rgmii_bus {
	rockchip,pins = <3 RK_PA4 3 &pcfg_pull_none>,
			<3 RK_PA5 3 &pcfg_pull_none>,
			<3 RK_PA2 3 &pcfg_pull_none_drv_level_2>,
			<3 RK_PA3 3 &pcfg_pull_none_drv_level_2>;
};

&gmac1m0_rgmii_bus_level3 {
	rockchip,pins = <3 RK_PA4 3 &pcfg_pull_none>,
			<3 RK_PA5 3 &pcfg_pull_none>,
			<3 RK_PA2 3 &pcfg_pull_none_drv_level_3>,
			<3 RK_PA3 3 &pcfg_pull_none_drv_level_3>;
};

&gmac1m0_rgmii_clk {
	rockchip,pins = <3 RK_PA7 3 &pcfg_pull_none>,
			<3 RK_PA6 3 &pcfg_pull_none_drv_level_1>;
};

&gmac1m0_rgmii_clk_level2 {
	rockchip,pins = <3 RK_PA7 3 &pcfg_pull_none>,
			<3 RK_PA6 3 &pcfg_pull_none_drv_level_2>;
};

&gmac1m0_rx_bus2 {
	rockchip,pins = <3 RK_PB1 3 &pcfg_pull_none>,
			<3 RK_PB2 3 &pcfg_pull_none>,
			<3 RK_PB3 3 &pcfg_pull_none>;
};

&gmac1m0_rx_er {
	rockchip,pins = <3 RK_PB4 3 &pcfg_pull_none>;
};

&gmac1m0_tx_bus2 {
	rockchip,pins = <3 RK_PB5 3 &pcfg_pull_none_drv_level_2>,
			<3 RK_PB6 3 &pcfg_pull_none_drv_level_2>,
			<3 RK_PB7 3 &pcfg_pull_none>;
};

&gmac1m0_tx_bus2_level3 {
	rockchip,pins = <3 RK_PB5 3 &pcfg_pull_none_drv_level_3>,
			<3 RK_PB6 3 &pcfg_pull_none_drv_level_3>,
			<3 RK_PB7 3 &pcfg_pull_none>;
};

&gmac1m1_clkinout {
	rockchip,pins = <4 RK_PC1 3 &pcfg_pull_none>;
};

&gmac1m1_miim {
	rockchip,pins = <4 RK_PB6 3 &pcfg_pull_none>,
			<4 RK_PB7 3 &pcfg_pull_none>;
};

&gmac1m1_rgmii_bus {
	rockchip,pins = <4 RK_PA1 3 &pcfg_pull_none>,
			<4 RK_PA2 3 &pcfg_pull_none>,
			<3 RK_PD6 3 &pcfg_pull_none_drv_level_2>,
			<3 RK_PD7 3 &pcfg_pull_none_drv_level_2>;
};

&gmac1m1_rgmii_bus_level3 {
	rockchip,pins = <4 RK_PA1 3 &pcfg_pull_none>,
			<4 RK_PA2 3 &pcfg_pull_none>,
			<3 RK_PD6 3 &pcfg_pull_none_drv_level_3>,
			<3 RK_PD7 3 &pcfg_pull_none_drv_level_3>;
};

&gmac1m1_rgmii_clk {
	rockchip,pins = <4 RK_PA3 3 &pcfg_pull_none>,
			<4 RK_PA0 3 &pcfg_pull_none_drv_level_1>;
};

&gmac1m1_rgmii_clk_level2 {
	rockchip,pins = <4 RK_PA3 3 &pcfg_pull_none>,
			<4 RK_PA0 3 &pcfg_pull_none_drv_level_2>;
};

&gmac1m1_rx_bus2 {
	rockchip,pins = <4 RK_PA7 3 &pcfg_pull_none>,
			<4 RK_PB0 3 &pcfg_pull_none>,
			<4 RK_PB1 3 &pcfg_pull_none>;
};

&gmac1m1_rx_er {
	rockchip,pins = <4 RK_PB2 3 &pcfg_pull_none>;
};

&gmac1m1_tx_bus2 {
	rockchip,pins = <4 RK_PA4 3 &pcfg_pull_none_drv_level_2>,
			<4 RK_PA5 3 &pcfg_pull_none_drv_level_2>,
			<4 RK_PA6 3 &pcfg_pull_none>;
};

&gmac1m1_tx_bus2_level3 {
	rockchip,pins = <4 RK_PA4 3 &pcfg_pull_none_drv_level_3>,
			<4 RK_PA5 3 &pcfg_pull_none_drv_level_3>,
			<4 RK_PA6 3 &pcfg_pull_none>;
};

&gmac_uio0 {
	rockchip,ethernet = <&gmac0>;
};

&gmac_uio1 {
	rockchip,ethernet = <&gmac1>;
};

&gpio0 {
	clocks = <&pmucru PCLK_GPIO0>, <&pmucru DBCLK_GPIO0>;
};

&gpio1 {
	clocks = <&cru PCLK_GPIO1>, <&cru DBCLK_GPIO1>;
};

&gpio2 {
	clocks = <&cru PCLK_GPIO2>, <&cru DBCLK_GPIO2>;
};

&gpio3 {
	clocks = <&cru PCLK_GPIO3>, <&cru DBCLK_GPIO3>;
};

&gpio4 {
	clocks = <&cru PCLK_GPIO4>, <&cru DBCLK_GPIO4>;
};

&gpu {
	clocks = <&scmi_clk 1>, <&cru CLK_GPU>;
	power-domains = <&power 7>;
	operating-points-v2 = <&gpu_opp_table>;
	status = "okay";
	mali-supply = <&vdd_gpu>;
};

&gpu_opp_table {
	nvmem-cells = <&gpu_leakage &core_pvtm &mbist_vmin &gpu_opp_info &specification_serial_number &remark_spec_serial_number>;
};

&gpu_pins {
	rockchip,pins = <0 RK_PC0 2 &pcfg_pull_none>,
			<0 RK_PA6 4 &pcfg_pull_none>;
};

&gpu_thermal {
	thermal-sensors = <&tsadc 1>;
};

&hdmi {
	clocks = <&cru PCLK_HDMI_HOST>, <&cru CLK_HDMI_SFR>, <&cru CLK_HDMI_CEC>, <&pmucru PLL_HPLL>, <&cru HCLK_VOP>;
	pinctrl-0 = <&hdmitx_scl &hdmitx_sda &hdmitxm0_cec>;
	power-domains = <&power 9>;
	rockchip,grf = <&grf>;
};

&hdmi_in_vp0 {
	remote-endpoint = <&vp0_out_hdmi>;
};

&hdmi_in_vp1 {
	remote-endpoint = <&vp1_out_hdmi>;
};

&hdmi_sound {
	simple-audio-card,name = "rockchip,hdmi";
	simple-audio-card,mclk-fs = <128>;

	simple-audio-card,codec {
		sound-dai = <&hdmi>;
	};

	simple-audio-card,cpu {
		sound-dai = <&i2s0_8ch>;
	};
};

&hdmitx_scl {
	rockchip,pins = <4 RK_PC7 1 &pcfg_pull_none>;
};

&hdmitx_sda {
	rockchip,pins = <4 RK_PD0 1 &pcfg_pull_none>;
};

&hdmitxm0_cec {
	rockchip,pins = <4 RK_PD1 1 &pcfg_pull_none>;
};

&hdmitxm1_cec {
	rockchip,pins = <0 RK_PC7 1 &pcfg_pull_none>;
};

&i2c0 {
	clocks = <&pmucru CLK_I2C0>, <&pmucru PCLK_I2C0>;
	pinctrl-0 = <&i2c0_xfer>;
	status = "okay";

	vdd_cpu: sti8070a@40 {
		compatible = "silergy,syr827";
		reg = <0x40>;
		vin-supply = <&vccsys>;
		regulator-compatible = "fan53555-reg";
		regulator-name = "vdd_cpu";
		regulator-min-microvolt = <712500>;
		regulator-max-microvolt = <1390000>;
		regulator-init-microvolt = <1000000>;
		regulator-ramp-delay = <2300>;
		fcs,suspend-voltage-selector = <1>;
		regulator-boot-on;
		regulator-always-on;
		regulator-state-mem {
			regulator-off-in-suspend;
		};
	};

	rk817: pmic@20 {
		compatible = "rockchip,rk817";
		reg = <0x20>;
		interrupt-parent = <&gpio0>;
		interrupts = <RK_PA3 IRQ_TYPE_LEVEL_LOW>;
		pinctrl-names = "default", "pmic-sleep", "pmic-power-off", "pmic-reset";
		pinctrl-0 = <&pmic_int>;
		pinctrl-1 = <&soc_slppin_slp>;
		pinctrl-2 = <&soc_slppin_gpio>;
		pinctrl-3 = <&soc_slppin_gpio>;
		rockchip,system-power-controller;
		wakeup-source;
		#clock-cells = <1>;
		clock-output-names = "rk808-clkout1", "rk808-clkout2";
		pmic-reset-func = <0>;
		not-save-power-en = <1>;
		vcc1-supply = <&vccsys>;
		vcc2-supply = <&vccsys>;
		vcc3-supply = <&vccsys>;
		vcc4-supply = <&vccsys>;
		vcc5-supply = <&vccsys>;
		vcc6-supply = <&vccsys>;
		vcc7-supply = <&vccsys>;
		vcc8-supply = <&vccsys>;
		vcc9-supply = <&dcdc_boost>;
		pwrkey {
			status = "okay";
		};
		pinctrl_rk8xx: pinctrl_rk8xx {
			gpio-controller;
			#gpio-cells = <2>;
			rk817_slppin_null: rk817_slppin_null {
				pins = "gpio_slp";
				function = "pin_fun0";
			};
			rk817_slppin_slp: rk817_slppin_slp {
				pins = "gpio_slp";
				function = "pin_fun1";
			};
			rk817_slppin_pwrdn: rk817_slppin_pwrdn {
				pins = "gpio_slp";
				function = "pin_fun2";
			};
			rk817_slppin_rst: rk817_slppin_rst {
				pins = "gpio_slp";
				function = "pin_fun3";
			};
		};
		regulators {
			vdd_logic: DCDC_REG1 {
				regulator-always-on;
				regulator-boot-on;
				regulator-min-microvolt = <900000>;
				regulator-max-microvolt = <1350000>;
				regulator-init-microvolt = <950000>;
				regulator-ramp-delay = <6001>;
				regulator-initial-mode = <2>;
				regulator-name = "vdd_logic";
				regulator-state-mem {
					regulator-on-in-suspend;
					regulator-suspend-microvolt = <900000>;
				};
			};
			vdd_gpu: DCDC_REG2 {
				regulator-always-on;
				regulator-boot-on;
				regulator-min-microvolt = <825000>;
				regulator-max-microvolt = <1350000>;
				regulator-init-microvolt = <950000>;
				regulator-ramp-delay = <6001>;
				regulator-initial-mode = <2>;
				regulator-name = "vdd_gpu";
				regulator-state-mem {
					regulator-off-in-suspend;
				};
			};
			vcc_ddr: DCDC_REG3 {
				regulator-always-on;
				regulator-boot-on;
				regulator-initial-mode = <2>;
				regulator-name = "vcc_ddr";
				regulator-state-mem {
					regulator-on-in-suspend;
				};
			};
			vcc_3v3: DCDC_REG4 {
				regulator-always-on;
				regulator-boot-on;
				regulator-min-microvolt = <3300000>;
				regulator-max-microvolt = <3300000>;
				regulator-initial-mode = <2>;
				regulator-name = "vcc_3v3";
				regulator-state-mem {
					regulator-on-in-suspend;
					regulator-suspend-microvolt = <3300000>;
				};
			};
			vcca1v8_pmu: LDO_REG1 {
				regulator-always-on;
				regulator-boot-on;
				regulator-min-microvolt = <1800000>;
				regulator-max-microvolt = <1800000>;
				regulator-name = "vcca1v8_pmu";
				regulator-state-mem {
					regulator-on-in-suspend;
					regulator-suspend-microvolt = <1800000>;
				};
			};
			vdda_0v9: LDO_REG2 {
				regulator-always-on;
				regulator-boot-on;
				regulator-min-microvolt = <900000>;
				regulator-max-microvolt = <900000>;
				regulator-name = "vdda_0v9";
				regulator-state-mem {
					regulator-off-in-suspend;
				};
			};
			vdda0v9_pmu: LDO_REG3 {
				regulator-always-on;
				regulator-boot-on;
				regulator-min-microvolt = <900000>;
				regulator-max-microvolt = <900000>;
				regulator-name = "vdda0v9_pmu";
				regulator-state-mem {
					regulator-on-in-suspend;
					regulator-suspend-microvolt = <900000>;
				};
			};
			vccio_acodec: LDO_REG4 {
				regulator-always-on;
				regulator-boot-on;
				regulator-min-microvolt = <3300000>;
				regulator-max-microvolt = <3300000>;
				regulator-name = "vccio_acodec";
				regulator-state-mem {
					regulator-off-in-suspend;
				};
			};
			vccio_sd: LDO_REG5 {
				regulator-always-on;
				regulator-boot-on;
				regulator-min-microvolt = <1800000>;
				regulator-max-microvolt = <3300000>;
				regulator-name = "vccio_sd";
				regulator-state-mem {
					regulator-off-in-suspend;
				};
			};
			vcc3v3_pmu: LDO_REG6 {
				regulator-always-on;
				regulator-boot-on;
				regulator-min-microvolt = <3300000>;
				regulator-max-microvolt = <3300000>;
				regulator-name = "vcc3v3_pmu";
				regulator-state-mem {
					regulator-on-in-suspend;
					regulator-suspend-microvolt = <3000000>;
				};
			};
			vcc_1v8: LDO_REG7 {
				regulator-always-on;
				regulator-boot-on;
				regulator-min-microvolt = <1800000>;
				regulator-max-microvolt = <1800000>;
				regulator-name = "vcc_1v8";
				regulator-state-mem {
					regulator-on-in-suspend;
				};
			};
			vcc1v8_dvp: LDO_REG8 {
				regulator-always-on;
				regulator-boot-on;
				regulator-min-microvolt = <1800000>;
				regulator-max-microvolt = <3300000>;
				regulator-name = "vcc1v8_dvp";
				regulator-state-mem {
					regulator-off-in-suspend;
				};
			};
			vcc2v8_dvp: LDO_REG9 {
				regulator-always-on;
				regulator-boot-on;
				regulator-min-microvolt = <2800000>;
				regulator-max-microvolt = <2800000>;
				regulator-name = "vcc2v8_dvp";
				regulator-state-mem {
					regulator-off-in-suspend;
				};
			};
			dcdc_boost: BOOST {
				regulator-always-on;
				regulator-boot-on;
				regulator-min-microvolt = <5000000>;
				regulator-max-microvolt = <5000000>;
				regulator-name = "boost";
				regulator-state-mem {
					regulator-off-in-suspend;
				};
			};
			otg_switch: OTG_SWITCH {
				regulator-name = "otg_switch";
				regulator-state-mem {
					regulator-off-in-suspend;
				};
			};
		};
		simple_battery: simple-battery {
			compatible = "simple-battery";
			charge-full-design-microamp-hours = <2500000>;
			precharge-current-microamp = <180000>;
			precharge-upper-limit-microvolt = <3600000>;
			charge-term-current-microamp = <300000>;
			constant-charge-current-max-microamp = <10000000>;
			constant-charge-voltage-max-microvolt = <4350000>;
			factory-internal-resistance-micro-ohms = <80>;
			voltage-max-design-microvolt = <4350000>;
			voltage-min-design-microvolt = <3000000>;
		};
		battery {
			compatible = "rk817,battery";
			ocv_table = <3400 3663 3677 3707 3731 3749 3761 3772 3786 3826 3861 3908 3947 3978 4039 4083 4136 4191 4251 4338>;
			design_capacity = <4247>;
			design_qmax = <4247>;
			bat_res = <69>;
			sleep_enter_current = <150>;
			sleep_exit_current = <180>;
			sleep_filter_current = <100>;
			power_off_thresd = <3500>;
			zero_algorithm_vol = <3850>;
			max_soc_offset = <60>;
			monitor_sec = <5>;
			sample_res = <10>;
			virtual_power = <0>;
			status = "okay";
		};
		charger: charger {
			compatible = "rk817,charger";
			min_input_voltage = <4500>;
			max_input_current = <3500>;
			max_chrg_current = <3000>;
			max_chrg_voltage = <4350>;
			chrg_term_mode = <2>;
			chrg_finish_cur = <200>;
			virtual_power = <0>;
			dc_det_adc = <0>;
			extcon = <&usb2phy0>;
			status = "okay";
		};
		rk817_codec: codec {
			#sound-dai-cells = <0>;
			compatible = "rockchip,rk817-codec";
			clocks = <&cru I2S1_MCLKOUT>;
			clock-names = "mclk";
			assigned-clocks = <&cru I2S1_MCLKOUT>, <&cru I2S1_MCLK_TX_IOE>;
			assigned-clock-rates = <12288000>;
			assigned-clock-parents = <&cru I2S1_MCLKOUT_TX>, <&cru I2S1_MCLKOUT_TX>;
			pinctrl-names = "default";
			pinctrl-0 = <&i2s1m0_mclk>;
			hp-volume = <23>;
			spk-volume = <10>;
			mic-in-differential;
			use-ext-amplifier;
			spk-ctl-gpios = <&gpio4 RK_PC3 GPIO_ACTIVE_HIGH>;
			status = "okay";
		};
	};

	cw2015@62 {
		compatible = "cellwise,cw2015";
		reg = <0x62>;
		cellwise,battery-profile = <392659311 1768252244 1968199510 1313817653 740564507 607273293 475466629 877943149 2239857028 1008430188 188816461 2157289492 947820707 2156500939 788554917 3049342638>;
		cellwise,monitor-interval-ms = <5000>;
		monitored-battery = <&simple_battery>;
		battery_id = <0>;
		status = "okay";
	};
};

&i2c0_xfer {
	rockchip,pins = <0 RK_PB1 1 &pcfg_pull_none_smt>,
			<0 RK_PB2 1 &pcfg_pull_none_smt>;
};

&i2c1 {
	clocks = <&cru CLK_I2C1>, <&cru PCLK_I2C1>;
	pinctrl-0 = <&i2c1_xfer>;
};

&i2c1_xfer {
	rockchip,pins = <0 RK_PB3 1 &pcfg_pull_none_smt>,
			<0 RK_PB4 1 &pcfg_pull_none_smt>;
};

&i2c2 {
	clocks = <&cru CLK_I2C2>, <&cru PCLK_I2C2>;
	pinctrl-0 = <&i2c2m1_xfer>;
	status = "okay";
	clock-frequency = <200000>;
	i2c-scl-rising-time-ns = <144>;
	i2c-scl-falling-time-ns = <4>;

	aw87391_pa_l: aw87391@58 {
		compatible = "aw,aw87391-left";
		reg = <0x58>;
	};

	aw87391_pa_r: aw87391@5b {
		compatible = "aw,aw87391-right";
		reg = <0x5b>;
	};

	icm42607_acc: icm_acc@68 {
		status = "okay";
		compatible = "icm42607_acc";
		reg = <0x68>;
		irq-gpio = <&gpio0 RK_PD6 GPIO_ACTIVE_LOW>;
		irq_enable = <0>;
		poll_delay_ms = <30>;
		type = <2>;
		layout = <5>;
	};

	icm42607_gyro: icm_gyro@68 {
		status = "okay";
		compatible = "icm42607_gyro";
		reg = <0x68>;
		poll_delay_ms = <30>;
		type = <4>;
		layout = <5>;
	};

	sc7u22_acc: sc7u22_acc@18 {
		compatible = "sc7u22_acc";
		reg = <0x18>;
		type = <2>;
		irq_enable = <0>;
		poll_delay_ms = <30>;
		layout = <5>;
		status = "okay";
	};

	sc7u22_gyro: sc7u22_gyro@18 {
		compatible = "sc7u22_gyro";
		reg = <0x18>;
		type = <4>;
		irq_enable = <0>;
		poll_delay_ms = <30>;
		layout = <5>;
		status = "okay";
	};
};

&i2c2m0_xfer {
	rockchip,pins = <0 RK_PB5 1 &pcfg_pull_none_smt>,
			<0 RK_PB6 1 &pcfg_pull_none_smt>;
};

&i2c2m1_xfer {
	rockchip,pins = <4 RK_PB5 1 &pcfg_pull_none_smt>,
			<4 RK_PB4 1 &pcfg_pull_none_smt>;
};

&i2c3 {
	clocks = <&cru CLK_I2C3>, <&cru PCLK_I2C3>;
	pinctrl-0 = <&i2c3m1_xfer>;
	status = "okay";
	clock-frequency = <400000>;
	i2c-scl-rising-time-ns = <144>;
	i2c-scl-falling-time-ns = <4>;

	gt9xx_1: gt9xx-1@14 {
		compatible = "goodix,gt9xx";
		reg = <0x14>;
		touch-gpio = <&gpio0 RK_PC0 GPIO_ACTIVE_LOW>;
		reset-gpio = <&gpio0 RK_PB7 GPIO_ACTIVE_HIGH>;
		max-x = <640>;
		max-y = <480>;
		tp-size = <911>;
		ext_lcd_tp = <1>;
		flip_report_tp = <1>;
		com_lcd_tp = <0>;
		pinctrl-names = "default";
		pinctrl-0 = <&touch1_gt_gpio>;
		rockchip,panel-notifier = <&dsi0_panel>;
	};
};

&i2c3m0_xfer {
	rockchip,pins = <1 RK_PA1 1 &pcfg_pull_none_smt>,
			<1 RK_PA0 1 &pcfg_pull_none_smt>;
};

&i2c3m1_xfer {
	rockchip,pins = <3 RK_PB5 4 &pcfg_pull_none_smt>,
			<3 RK_PB6 4 &pcfg_pull_none_smt>;
};

&i2c4 {
	clocks = <&cru CLK_I2C4>, <&cru PCLK_I2C4>;
	pinctrl-0 = <&i2c4m0_xfer>;
};

&i2c4m0_xfer {
	rockchip,pins = <4 RK_PB3 1 &pcfg_pull_none_smt>,
			<4 RK_PB2 1 &pcfg_pull_none_smt>;
};

&i2c4m1_xfer {
	rockchip,pins = <2 RK_PB2 2 &pcfg_pull_none_smt>,
			<2 RK_PB1 2 &pcfg_pull_none_smt>;
};

&i2c5 {
	clocks = <&cru CLK_I2C5>, <&cru PCLK_I2C5>;
	pinctrl-0 = <&i2c5m0_xfer>;
	status = "okay";
	clock-frequency = <400000>;
	i2c-scl-rising-time-ns = <144>;
	i2c-scl-falling-time-ns = <4>;

	gt9xx_0: gt9xx-0@14 {
		compatible = "goodix,gt9xx";
		reg = <0x14>;
		touch-gpio = <&gpio0 RK_PB6 GPIO_ACTIVE_LOW>;
		reset-gpio = <&gpio0 RK_PB5 GPIO_ACTIVE_HIGH>;
		max-x = <640>;
		max-y = <480>;
		tp-size = <911>;
		ext_lcd_tp = <0>;
		flip_report_tp = <0>;
		com_lcd_tp = <0>;
		pinctrl-names = "default";
		pinctrl-0 = <&touch0_gt_gpio>;
		rockchip,panel-notifier = <&dsi0_panel>;
	};
};

&i2c5m0_xfer {
	rockchip,pins = <3 RK_PB3 4 &pcfg_pull_none_smt>,
			<3 RK_PB4 4 &pcfg_pull_none_smt>;
};

&i2c5m1_xfer {
	rockchip,pins = <4 RK_PC7 2 &pcfg_pull_none_smt>,
			<4 RK_PD0 2 &pcfg_pull_none_smt>;
};

&i2s0_8ch {
	clocks = <&cru MCLK_I2S0_8CH_TX>, <&cru MCLK_I2S0_8CH_RX>, <&cru HCLK_I2S0_8CH>;
	dmas = <&dmac1 0>;
	resets = <&cru SRST_M_I2S0_8CH_TX>, <&cru SRST_M_I2S0_8CH_RX>;
	rockchip,cru = <&cru>;
	rockchip,grf = <&grf>;
	status = "okay";
};

&i2s1_8ch {
	clocks = <&cru MCLK_I2S1_8CH_TX>, <&cru MCLK_I2S1_8CH_RX>, <&cru HCLK_I2S1_8CH>;
	dmas = <&dmac1 2>, <&dmac1 3>;
	resets = <&cru SRST_M_I2S1_8CH_TX>, <&cru SRST_M_I2S1_8CH_RX>;
	rockchip,cru = <&cru>;
	rockchip,grf = <&grf>;
	i2s-lrck-gpio = <&gpio1 RK_PA5 GPIO_ACTIVE_HIGH>;
	pinctrl-0 = <&i2s1m0_sclktx &i2s1m0_lrcktx &i2s1m0_sdi0 &i2s1m0_sdo0>;
	status = "okay";
	rockchip,trcm-sync-tx-only;
};

&i2s1m0_lrckrx {
	rockchip,pins = <1 RK_PA6 1 &pcfg_pull_none_smt>;
};

&i2s1m0_lrcktx {
	rockchip,pins = <1 RK_PA5 1 &pcfg_pull_none_smt>;
};

&i2s1m0_mclk {
	rockchip,pins = <1 RK_PA2 1 &pcfg_pull_none_smt>;
};

&i2s1m0_sclkrx {
	rockchip,pins = <1 RK_PA4 1 &pcfg_pull_none_smt>;
};

&i2s1m0_sclktx {
	rockchip,pins = <1 RK_PA3 1 &pcfg_pull_none_smt>;
};

&i2s1m0_sdi0 {
	rockchip,pins = <1 RK_PB3 1 &pcfg_pull_none>;
};

&i2s1m0_sdi1 {
	rockchip,pins = <1 RK_PB2 2 &pcfg_pull_none>;
};

&i2s1m0_sdi2 {
	rockchip,pins = <1 RK_PB1 2 &pcfg_pull_none>;
};

&i2s1m0_sdi3 {
	rockchip,pins = <1 RK_PB0 2 &pcfg_pull_none>;
};

&i2s1m0_sdo0 {
	rockchip,pins = <1 RK_PA7 1 &pcfg_pull_none>;
};

&i2s1m0_sdo1 {
	rockchip,pins = <1 RK_PB0 1 &pcfg_pull_none>;
};

&i2s1m0_sdo2 {
	rockchip,pins = <1 RK_PB1 1 &pcfg_pull_none>;
};

&i2s1m0_sdo3 {
	rockchip,pins = <1 RK_PB2 1 &pcfg_pull_none>;
};

&i2s1m1_lrckrx {
	rockchip,pins = <4 RK_PA7 5 &pcfg_pull_none_smt>;
};

&i2s1m1_lrcktx {
	rockchip,pins = <3 RK_PD0 4 &pcfg_pull_none_smt>;
};

&i2s1m1_mclk {
	rockchip,pins = <3 RK_PC6 4 &pcfg_pull_none_smt>;
};

&i2s1m1_sclkrx {
	rockchip,pins = <4 RK_PA6 5 &pcfg_pull_none_smt>;
};

&i2s1m1_sclktx {
	rockchip,pins = <3 RK_PC7 4 &pcfg_pull_none_smt>;
};

&i2s1m1_sdi0 {
	rockchip,pins = <3 RK_PD2 4 &pcfg_pull_none>;
};

&i2s1m1_sdi1 {
	rockchip,pins = <3 RK_PD3 4 &pcfg_pull_none>;
};

&i2s1m1_sdi2 {
	rockchip,pins = <3 RK_PD4 4 &pcfg_pull_none>;
};

&i2s1m1_sdi3 {
	rockchip,pins = <3 RK_PD5 4 &pcfg_pull_none>;
};

&i2s1m1_sdo0 {
	rockchip,pins = <3 RK_PD1 4 &pcfg_pull_none>;
};

&i2s1m1_sdo1 {
	rockchip,pins = <4 RK_PB0 5 &pcfg_pull_none>;
};

&i2s1m1_sdo2 {
	rockchip,pins = <4 RK_PB1 4 &pcfg_pull_none>;
};

&i2s1m1_sdo3 {
	rockchip,pins = <4 RK_PB5 4 &pcfg_pull_none>;
};

&i2s1m2_lrckrx {
	rockchip,pins = <3 RK_PC5 5 &pcfg_pull_none_smt>;
};

&i2s1m2_lrcktx {
	rockchip,pins = <2 RK_PD2 5 &pcfg_pull_none_smt>;
};

&i2s1m2_mclk {
	rockchip,pins = <2 RK_PD0 5 &pcfg_pull_none_smt>;
};

&i2s1m2_sclkrx {
	rockchip,pins = <3 RK_PC3 5 &pcfg_pull_none_smt>;
};

&i2s1m2_sclktx {
	rockchip,pins = <2 RK_PD1 5 &pcfg_pull_none_smt>;
};

&i2s1m2_sdi0 {
	rockchip,pins = <2 RK_PD3 5 &pcfg_pull_none>;
};

&i2s1m2_sdi1 {
	rockchip,pins = <2 RK_PD4 5 &pcfg_pull_none>;
};

&i2s1m2_sdi2 {
	rockchip,pins = <2 RK_PD5 5 &pcfg_pull_none>;
};

&i2s1m2_sdi3 {
	rockchip,pins = <2 RK_PD6 5 &pcfg_pull_none>;
};

&i2s1m2_sdo0 {
	rockchip,pins = <2 RK_PD7 5 &pcfg_pull_none>;
};

&i2s1m2_sdo1 {
	rockchip,pins = <3 RK_PA0 5 &pcfg_pull_none>;
};

&i2s1m2_sdo2 {
	rockchip,pins = <3 RK_PC1 5 &pcfg_pull_none>;
};

&i2s1m2_sdo3 {
	rockchip,pins = <3 RK_PC2 5 &pcfg_pull_none>;
};

&i2s2_2ch {
	clocks = <&cru MCLK_I2S2_2CH>, <&cru MCLK_I2S2_2CH>, <&cru HCLK_I2S2_2CH>;
	dmas = <&dmac1 4>, <&dmac1 5>;
	rockchip,cru = <&cru>;
	rockchip,grf = <&grf>;
	i2s-lrck-gpio = <&gpio2 RK_PC3 GPIO_ACTIVE_HIGH>;
	pinctrl-0 = <&i2s2m0_sclktx &i2s2m0_lrcktx &i2s2m0_sdi &i2s2m0_sdo>;
};

&i2s2m0_lrckrx {
	rockchip,pins = <2 RK_PC0 1 &pcfg_pull_none_smt>;
};

&i2s2m0_lrcktx {
	rockchip,pins = <2 RK_PC3 1 &pcfg_pull_none_smt>;
};

&i2s2m0_mclk {
	rockchip,pins = <2 RK_PC1 1 &pcfg_pull_none_smt>;
};

&i2s2m0_sclkrx {
	rockchip,pins = <2 RK_PB7 1 &pcfg_pull_none_smt>;
};

&i2s2m0_sclktx {
	rockchip,pins = <2 RK_PC2 1 &pcfg_pull_none_smt>;
};

&i2s2m0_sdi {
	rockchip,pins = <2 RK_PC5 1 &pcfg_pull_none>;
};

&i2s2m0_sdo {
	rockchip,pins = <2 RK_PC4 1 &pcfg_pull_none>;
};

&i2s2m1_lrckrx {
	rockchip,pins = <4 RK_PA5 5 &pcfg_pull_none_smt>;
};

&i2s2m1_lrcktx {
	rockchip,pins = <4 RK_PA4 5 &pcfg_pull_none_smt>;
};

&i2s2m1_mclk {
	rockchip,pins = <4 RK_PB6 5 &pcfg_pull_none_smt>;
};

&i2s2m1_sclkrx {
	rockchip,pins = <4 RK_PC1 5 &pcfg_pull_none_smt>;
};

&i2s2m1_sclktx {
	rockchip,pins = <4 RK_PB7 4 &pcfg_pull_none_smt>;
};

&i2s2m1_sdi {
	rockchip,pins = <4 RK_PB2 5 &pcfg_pull_none>;
};

&i2s2m1_sdo {
	rockchip,pins = <4 RK_PB3 5 &pcfg_pull_none>;
};

&i2s3_2ch {
	clocks = <&cru MCLK_I2S3_2CH_TX>, <&cru MCLK_I2S3_2CH_RX>, <&cru HCLK_I2S3_2CH>;
	dmas = <&dmac1 6>, <&dmac1 7>;
	resets = <&cru SRST_M_I2S3_2CH_TX>, <&cru SRST_M_I2S3_2CH_RX>;
	rockchip,cru = <&cru>;
	rockchip,grf = <&grf>;
	i2s-lrck-gpio = <&gpio3 RK_PA4 GPIO_ACTIVE_HIGH>;
	pinctrl-0 = <&i2s3m0_sclk &i2s3m0_lrck &i2s3m0_sdi &i2s3m0_sdo>;
};

&i2s3m0_lrck {
	rockchip,pins = <3 RK_PA4 4 &pcfg_pull_none_smt>;
};

&i2s3m0_mclk {
	rockchip,pins = <3 RK_PA2 4 &pcfg_pull_none_smt>;
};

&i2s3m0_sclk {
	rockchip,pins = <3 RK_PA3 4 &pcfg_pull_none_smt>;
};

&i2s3m0_sdi {
	rockchip,pins = <3 RK_PA6 4 &pcfg_pull_none>;
};

&i2s3m0_sdo {
	rockchip,pins = <3 RK_PA5 4 &pcfg_pull_none>;
};

&i2s3m1_lrck {
	rockchip,pins = <4 RK_PC4 5 &pcfg_pull_none_smt>;
};

&i2s3m1_mclk {
	rockchip,pins = <4 RK_PC2 5 &pcfg_pull_none_smt>;
};

&i2s3m1_sclk {
	rockchip,pins = <4 RK_PC3 5 &pcfg_pull_none_smt>;
};

&i2s3m1_sdi {
	rockchip,pins = <4 RK_PC6 5 &pcfg_pull_none>;
};

&i2s3m1_sdo {
	rockchip,pins = <4 RK_PC5 5 &pcfg_pull_none>;
};

&iep {
	clocks = <&cru ACLK_IEP>, <&cru HCLK_IEP>, <&cru CLK_IEP_CORE>;
	resets = <&cru SRST_A_IEP>, <&cru SRST_H_IEP>, <&cru SRST_IEP_CORE>;
	power-domains = <&power 10>;
	rockchip,srv = <&mpp_srv>;
	iommus = <&iep_mmu>;
	status = "okay";
};

&iep_mmu {
	clocks = <&cru ACLK_IEP>, <&cru HCLK_IEP>;
	power-domains = <&power 10>;
	status = "okay";
};

&isp_pins {
	rockchip,pins = <4 RK_PB4 4 &pcfg_pull_none>,
			<4 RK_PA6 1 &pcfg_pull_none>,
			<4 RK_PB1 1 &pcfg_pull_none>;
};

&jpegd {
	clocks = <&cru ACLK_JDEC>, <&cru HCLK_JDEC>;
	resets = <&cru SRST_A_JDEC>, <&cru SRST_H_JDEC>;
	iommus = <&jpegd_mmu>;
	rockchip,srv = <&mpp_srv>;
	power-domains = <&power 10>;
	status = "okay";
};

&jpegd_mmu {
	clocks = <&cru ACLK_JDEC>, <&cru HCLK_JDEC>;
	power-domains = <&power 10>;
	status = "okay";
};

&jtag_pins {
	rockchip,pins = <1 RK_PD7 2 &pcfg_pull_none>,
			<2 RK_PA0 2 &pcfg_pull_none>;
};

&lcdc_ctl {
	rockchip,pins = <3 RK_PA0 1 &pcfg_pull_none>,
			<2 RK_PD0 1 &pcfg_pull_none>,
			<2 RK_PD1 1 &pcfg_pull_none>,
			<2 RK_PD2 1 &pcfg_pull_none>,
			<2 RK_PD3 1 &pcfg_pull_none>,
			<2 RK_PD4 1 &pcfg_pull_none>,
			<2 RK_PD5 1 &pcfg_pull_none>,
			<2 RK_PD6 1 &pcfg_pull_none>,
			<2 RK_PD7 1 &pcfg_pull_none>,
			<3 RK_PA1 1 &pcfg_pull_none>,
			<3 RK_PA2 1 &pcfg_pull_none>,
			<3 RK_PA3 1 &pcfg_pull_none>,
			<3 RK_PA4 1 &pcfg_pull_none>,
			<3 RK_PA5 1 &pcfg_pull_none>,
			<3 RK_PA6 1 &pcfg_pull_none>,
			<3 RK_PA7 1 &pcfg_pull_none>,
			<3 RK_PB0 1 &pcfg_pull_none>,
			<3 RK_PB1 1 &pcfg_pull_none>,
			<3 RK_PB2 1 &pcfg_pull_none>,
			<3 RK_PB3 1 &pcfg_pull_none>,
			<3 RK_PB4 1 &pcfg_pull_none>,
			<3 RK_PB5 1 &pcfg_pull_none>,
			<3 RK_PB6 1 &pcfg_pull_none>,
			<3 RK_PB7 1 &pcfg_pull_none>,
			<3 RK_PC0 1 &pcfg_pull_none>,
			<3 RK_PC3 1 &pcfg_pull_none>,
			<3 RK_PC1 1 &pcfg_pull_none>,
			<3 RK_PC2 1 &pcfg_pull_none>;
};

&lvds0 {
	phys = <&video_phy0>;
};

&lvds0_in_vp1 {
	remote-endpoint = <&vp1_out_lvds>;
};

&lvds0_in_vp2 {
	remote-endpoint = <&vp2_out_lvds>;
};

&lvds1 {
	phys = <&video_phy1>;
};

&lvds1_in_vp1 {
	remote-endpoint = <&vp1_out_lvds1>;
};

&lvds1_in_vp2 {
	remote-endpoint = <&vp2_out_lvds1>;
};

&mailbox {
	clocks = <&cru PCLK_MAILBOX>;
};

&mcu_pins {
	rockchip,pins = <0 RK_PB4 4 &pcfg_pull_none>,
			<0 RK_PC1 4 &pcfg_pull_none>,
			<0 RK_PB3 4 &pcfg_pull_none>,
			<0 RK_PC2 4 &pcfg_pull_none>,
			<0 RK_PC3 4 &pcfg_pull_none>;
};

&mipi_csi2 {
	rockchip,hw = <&mipi_csi2_hw>;
};

&mipi_csi2_hw {
	clocks = <&cru PCLK_CSI2HOST1>;
	resets = <&cru SRST_P_CSI2HOST1>;
};

&mpp_srv {
	status = "okay";
};

&nandc0 {
	clocks = <&cru NCLK_NANDC>, <&cru HCLK_NANDC>;
	status = "okay";
};

&nfc {
	clocks = <&cru HCLK_NANDC>, <&cru NCLK_NANDC>;
	assigned-clocks = <&cru NCLK_NANDC>;
};

&npu_opp_table {
	nvmem-cells = <&npu_leakage &core_pvtm &mbist_vmin &npu_opp_info &specification_serial_number &remark_spec_serial_number>;
};

&npu_pins {
	rockchip,pins = <0 RK_PC1 2 &pcfg_pull_none>;
};

&otp {
	clocks = <&cru CLK_OTPC_NS_USR>, <&cru CLK_OTPC_NS_SBPI>, <&cru PCLK_OTPC_NS>, <&cru PCLK_OTPPHY>;
	resets = <&cru SRST_OTPPHY>;
};

&pcie20_buttonrstn {
	rockchip,pins = <0 RK_PB4 3 &pcfg_pull_none>;
};

&pcie20m0_pins {
	rockchip,pins = <0 RK_PA5 3 &pcfg_pull_none>,
			<0 RK_PB6 3 &pcfg_pull_none>,
			<0 RK_PB5 3 &pcfg_pull_none>;
};

&pcie20m1_pins {
	rockchip,pins = <2 RK_PD0 4 &pcfg_pull_none>,
			<3 RK_PC1 4 &pcfg_pull_none>,
			<2 RK_PD1 4 &pcfg_pull_none>;
};

&pcie20m2_pins {
	rockchip,pins = <1 RK_PB0 4 &pcfg_pull_none>,
			<1 RK_PB2 4 &pcfg_pull_none>,
			<1 RK_PB1 4 &pcfg_pull_none>;
};

&pcie2x1 {
	clocks = <&cru ACLK_PCIE20_MST>, <&cru ACLK_PCIE20_SLV>, <&cru ACLK_PCIE20_DBI>, <&cru PCLK_PCIE20>, <&cru CLK_PCIE20_AUX_NDFT>;
	interrupt-map = <0x0 0x0 0x0 0x1 &pcie2x1_intc 0x0 0x0 0x0 0x0 0x2 &pcie2x1_intc 0x1 0x0 0x0 0x0 0x3 &pcie2x1_intc 0x2 0x0 0x0 0x0 0x4 &pcie2x1_intc 0x3>;
	msi-map = <0x0 &its 0x0 0x1000>;
	phys = <&combphy2_psq 2>;
	power-domains = <&power 15>;
	resets = <&cru SRST_PCIE20_POWERUP>;
};

&pcie30phy {
	clocks = <&pmucru CLK_PCIE30PHY_REF_M>, <&pmucru CLK_PCIE30PHY_REF_N>, <&cru PCLK_PCIE30PHY>;
	resets = <&cru SRST_PCIE30PHY>;
	rockchip,phy-grf = <&pcie30_phy_grf>;
};

&pcie30x1_buttonrstn {
	rockchip,pins = <0 RK_PB3 3 &pcfg_pull_none>;
};

&pcie30x1m0_pins {
	rockchip,pins = <0 RK_PA4 3 &pcfg_pull_none>,
			<0 RK_PC3 3 &pcfg_pull_none>,
			<0 RK_PC2 3 &pcfg_pull_none>;
};

&pcie30x1m1_pins {
	rockchip,pins = <2 RK_PD2 4 &pcfg_pull_none>,
			<3 RK_PA1 4 &pcfg_pull_none>,
			<2 RK_PD3 4 &pcfg_pull_none>;
};

&pcie30x1m2_pins {
	rockchip,pins = <1 RK_PA5 4 &pcfg_pull_none>,
			<1 RK_PA2 4 &pcfg_pull_none>,
			<1 RK_PA3 4 &pcfg_pull_none>;
};

&pcie30x2_buttonrstn {
	rockchip,pins = <0 RK_PB0 3 &pcfg_pull_none>;
};

&pcie30x2m0_pins {
	rockchip,pins = <0 RK_PA6 2 &pcfg_pull_none>,
			<0 RK_PC6 3 &pcfg_pull_none>,
			<0 RK_PC5 3 &pcfg_pull_none>;
};

&pcie30x2m1_pins {
	rockchip,pins = <2 RK_PD4 4 &pcfg_pull_none>,
			<2 RK_PD6 4 &pcfg_pull_none>,
			<2 RK_PD5 4 &pcfg_pull_none>;
};

&pcie30x2m2_pins {
	rockchip,pins = <4 RK_PC2 4 &pcfg_pull_none>,
			<4 RK_PC4 4 &pcfg_pull_none>,
			<4 RK_PC3 4 &pcfg_pull_none>;
};

&pcie3x1 {
	clocks = <&cru ACLK_PCIE30X1_MST>, <&cru ACLK_PCIE30X1_SLV>, <&cru ACLK_PCIE30X1_DBI>, <&cru PCLK_PCIE30X1>, <&cru CLK_PCIE30X1_AUX_NDFT>;
	interrupt-map = <0x0 0x0 0x0 0x1 &pcie3x1_intc 0x0 0x0 0x0 0x0 0x2 &pcie3x1_intc 0x1 0x0 0x0 0x0 0x3 &pcie3x1_intc 0x2 0x0 0x0 0x0 0x4 &pcie3x1_intc 0x3>;
	msi-map = <0x1000 &its 0x1000 0x1000>;
	phys = <&pcie30phy>;
	power-domains = <&power 15>;
	resets = <&cru SRST_PCIE30X1_POWERUP>;
};

&pcie3x2 {
	clocks = <&cru ACLK_PCIE30X2_MST>, <&cru ACLK_PCIE30X2_SLV>, <&cru ACLK_PCIE30X2_DBI>, <&cru PCLK_PCIE30X2>, <&cru CLK_PCIE30X2_AUX_NDFT>;
	interrupt-map = <0x0 0x0 0x0 0x1 &pcie3x2_intc 0x0 0x0 0x0 0x0 0x2 &pcie3x2_intc 0x1 0x0 0x0 0x0 0x3 &pcie3x2_intc 0x2 0x0 0x0 0x0 0x4 &pcie3x2_intc 0x3>;
	msi-map = <0x2000 &its 0x2000 0x1000>;
	phys = <&pcie30phy>;
	power-domains = <&power 15>;
	resets = <&cru SRST_PCIE30X2_POWERUP>;
};

&pdm {
	clocks = <&cru MCLK_PDM>, <&cru HCLK_PDM>;
	dmas = <&dmac1 9>;
	pinctrl-0 = <&pdmm0_clk &pdmm0_clk1 &pdmm0_sdi0 &pdmm0_sdi1 &pdmm0_sdi2 &pdmm0_sdi3>;
	resets = <&cru SRST_M_PDM>;
};

&pdmm0_clk {
	rockchip,pins = <1 RK_PA6 3 &pcfg_pull_none>;
};

&pdmm0_clk1 {
	rockchip,pins = <1 RK_PA4 3 &pcfg_pull_none>;
};

&pdmm0_sdi0 {
	rockchip,pins = <1 RK_PB3 2 &pcfg_pull_none>;
};

&pdmm0_sdi1 {
	rockchip,pins = <1 RK_PB2 3 &pcfg_pull_none>;
};

&pdmm0_sdi2 {
	rockchip,pins = <1 RK_PB1 3 &pcfg_pull_none>;
};

&pdmm0_sdi3 {
	rockchip,pins = <1 RK_PB0 3 &pcfg_pull_none>;
};

&pdmm1_clk {
	rockchip,pins = <3 RK_PD6 5 &pcfg_pull_none>;
};

&pdmm1_clk1 {
	rockchip,pins = <4 RK_PA0 4 &pcfg_pull_none>;
};

&pdmm1_sdi0 {
	rockchip,pins = <3 RK_PD7 5 &pcfg_pull_none>;
};

&pdmm1_sdi1 {
	rockchip,pins = <4 RK_PA1 4 &pcfg_pull_none>;
};

&pdmm1_sdi2 {
	rockchip,pins = <4 RK_PA2 5 &pcfg_pull_none>;
};

&pdmm1_sdi3 {
	rockchip,pins = <4 RK_PA3 5 &pcfg_pull_none>;
};

&pdmm2_clk1 {
	rockchip,pins = <3 RK_PC4 5 &pcfg_pull_none>;
};

&pdmm2_sdi0 {
	rockchip,pins = <3 RK_PB3 5 &pcfg_pull_none>;
};

&pdmm2_sdi1 {
	rockchip,pins = <3 RK_PB4 5 &pcfg_pull_none>;
};

&pdmm2_sdi2 {
	rockchip,pins = <3 RK_PB7 5 &pcfg_pull_none>;
};

&pdmm2_sdi3 {
	rockchip,pins = <3 RK_PC0 5 &pcfg_pull_none>;
};

&pinctrl {
	rockchip,grf = <&grf>;
	rockchip,pmu = <&pmugrf>;

	lcd {
		mipi_dsi0_pwr_en: mipi-dsi0-pwr-en {
			rockchip,pins = <4 RK_PA4 RK_FUNC_GPIO &pcfg_pull_none>;
		};
		mipi_dsi1_pwr_en: mipi-dsi1-pwr-en {
			rockchip,pins = <4 RK_PA3 RK_FUNC_GPIO &pcfg_pull_none>;
		};
		lcd_rst_gpio: lcd-rst-gpio {
			rockchip,pins = <0 RK_PB3 RK_FUNC_GPIO &pcfg_pull_none>;
		};
		lcd_enable_gpio: lcd-enable-gpio {
			rockchip,pins = <0 RK_PB0 RK_FUNC_GPIO &pcfg_pull_none>,
					<0 RK_PC7 RK_FUNC_GPIO &pcfg_pull_none>;
		};
		lcd1_rst_gpio: lcd1-rst-gpio {
			rockchip,pins = <0 RK_PB4 RK_FUNC_GPIO &pcfg_pull_none>;
		};
		lcd1_enable_gpio: lcd1-enable-gpio {
			rockchip,pins = <0 RK_PC1 RK_FUNC_GPIO &pcfg_pull_none>,
					<0 RK_PC2 RK_FUNC_GPIO &pcfg_pull_none>;
		};
	};

	tp {
		touch0_gt_gpio: touch0-gt-gpio {
			rockchip,pins = <0 RK_PB5 RK_FUNC_GPIO &pcfg_pull_up>,
					<0 RK_PB6 RK_FUNC_GPIO &pcfg_pull_up>;
		};
		touch1_gt_gpio: touch1-gt-gpio {
			rockchip,pins = <0 RK_PB7 RK_FUNC_GPIO &pcfg_pull_up>,
					<0 RK_PC0 RK_FUNC_GPIO &pcfg_pull_up>;
		};
	};

	headphone {
		hp_det: hp-det {
			rockchip,pins = <4 RK_PC2 RK_FUNC_GPIO &pcfg_pull_none>;
		};
	};

	sensor {
		sensor_gpio: sensor-gpio {
			rockchip,pins = <0 RK_PD6 RK_FUNC_GPIO &pcfg_pull_none>;
		};
	};

	sdio-pwrseq {
		wifi_enable_h: wifi-enable-h {
			rockchip,pins = <4 RK_PA2 RK_FUNC_GPIO &pcfg_pull_none>;
		};
	};

	vcc_sd {
		vcc_sd_h: vcc-sd-h {
			rockchip,pins = <0 RK_PA5 RK_FUNC_GPIO &pcfg_pull_none>;
		};
	};

	power-wlan-bt {
		vcc_wifi_h: vcc-wifi-h {
			rockchip,pins = <0 RK_PA0 RK_FUNC_GPIO &pcfg_pull_none>;
		};
	};

	wireless-wlan {
		wifi_host_wake_irq: wifi-host-wake-irq {
			rockchip,pins = <4 RK_PA1 RK_FUNC_GPIO &pcfg_pull_down>;
		};
	};

	wireless-bluetooth {
		uart1_gpios: uart1-gpios {
			rockchip,pins = <4 RK_PB6 RK_FUNC_GPIO &pcfg_pull_none>;
		};
	};

	gpio-leds {
		leds_gpio: leds-gpio {
			rockchip,pins = <0 RK_PC5 RK_FUNC_GPIO &pcfg_pull_none>,
					<0 RK_PC6 RK_FUNC_GPIO &pcfg_pull_none>,
					<0 RK_PC4 RK_FUNC_GPIO &pcfg_pull_none>;
		};
	};

	btns {
		btn_pins: btn-pins {
			rockchip,pins = <2 RK_PD0 RK_FUNC_GPIO &pcfg_pull_up>,
					<2 RK_PD1 RK_FUNC_GPIO &pcfg_pull_up>,
					<2 RK_PD2 RK_FUNC_GPIO &pcfg_pull_up>,
					<2 RK_PD3 RK_FUNC_GPIO &pcfg_pull_up>,
					<2 RK_PD4 RK_FUNC_GPIO &pcfg_pull_up>,
					<2 RK_PD5 RK_FUNC_GPIO &pcfg_pull_up>,
					<2 RK_PD6 RK_FUNC_GPIO &pcfg_pull_up>,
					<2 RK_PD7 RK_FUNC_GPIO &pcfg_pull_up>,
					<3 RK_PA0 RK_FUNC_GPIO &pcfg_pull_up>,
					<3 RK_PA3 RK_FUNC_GPIO &pcfg_pull_up>,
					<3 RK_PA4 RK_FUNC_GPIO &pcfg_pull_up>,
					<3 RK_PA5 RK_FUNC_GPIO &pcfg_pull_up>,
					<3 RK_PA6 RK_FUNC_GPIO &pcfg_pull_up>,
					<3 RK_PA7 RK_FUNC_GPIO &pcfg_pull_up>,
					<3 RK_PB0 RK_FUNC_GPIO &pcfg_pull_up>,
					<3 RK_PB1 RK_FUNC_GPIO &pcfg_pull_up>,
					<3 RK_PB2 RK_FUNC_GPIO &pcfg_pull_up>,
					<3 RK_PB7 RK_FUNC_GPIO &pcfg_pull_up>,
					<3 RK_PC0 RK_FUNC_GPIO &pcfg_pull_up>,
					<3 RK_PC1 RK_FUNC_GPIO &pcfg_pull_up>,
					<3 RK_PC2 RK_FUNC_GPIO &pcfg_pull_up>,
					<3 RK_PC3 RK_FUNC_GPIO &pcfg_pull_up>;
		};
	};

	keys {
		pwr_key: pwr-key {
			rockchip,pins = <3 RK_PA1 RK_FUNC_GPIO &pcfg_pull_up>,
					<3 RK_PA2 RK_FUNC_GPIO &pcfg_pull_up>;
		};
	};

	halls {
		gpio_hall: gpio-hall {
			rockchip,pins = <0 RK_PC3 RK_FUNC_GPIO &pcfg_pull_up>;
		};
	};

	pmic {
		pmic_int: pmic_int {
			rockchip,pins = <0 RK_PA3 RK_FUNC_GPIO &pcfg_pull_up>;
		};

		soc_slppin_gpio: soc_slppin_gpio {
			rockchip,pins = <0 RK_PA2 RK_FUNC_GPIO &pcfg_output_low>;
		};

		soc_slppin_slp: soc_slppin_slp {
			rockchip,pins = <0 RK_PA2 1 &pcfg_pull_none>;
		};

		soc_slppin_rst: soc_slppin_rst {
			rockchip,pins = <0 RK_PA2 2 &pcfg_pull_none>;
		};
	};
};

&pmic_pins {
	rockchip,pins = <0 RK_PA2 1 &pcfg_pull_none>;
};

&pmu_io_domains {
	status = "okay";
	pmuio1-supply = <&vcc3v3_pmu>;
	pmuio2-supply = <&vcc3v3_pmu>;
	vccio1-supply = <&vccio_acodec>;
	vccio3-supply = <&vccio_sd>;
	vccio4-supply = <&vcc_3v3>;
	vccio5-supply = <&vcc_3v3>;
	vccio6-supply = <&vcc_1v8>;
	vccio7-supply = <&vcc_3v3>;
};

&pmu_pins {
	rockchip,pins = <0 RK_PA5 4 &pcfg_pull_none>,
			<0 RK_PA6 3 &pcfg_pull_none>,
			<0 RK_PC4 4 &pcfg_pull_none>,
			<0 RK_PC5 4 &pcfg_pull_none>,
			<0 RK_PC6 4 &pcfg_pull_none>,
			<0 RK_PC7 4 &pcfg_pull_none>;
};

&pmucru {
	rockchip,grf = <&grf>;
	rockchip,pmugrf = <&pmugrf>;
	assigned-clocks = <&pmucru SCLK_32K_IOE>;
	assigned-clock-parents = <&pmucru CLK_RTC_32K>;
};

&power {
	power-domain@6 {
		clocks = <&cru ACLK_NPU_PRE>, <&cru HCLK_NPU_PRE>, <&cru PCLK_NPU_PRE>;
		pm_qos = <&qos_npu>;
	};

	power-domain@7 {
		clocks = <&cru ACLK_GPU_PRE>, <&cru PCLK_GPU_PRE>;
		pm_qos = <&qos_gpu>;
	};

	power-domain@8 {
		clocks = <&cru HCLK_VI>, <&cru PCLK_VI>;
		pm_qos = <&qos_isp &qos_vicap0 &qos_vicap1>;
	};

	power-domain@9 {
		clocks = <&cru HCLK_VO>, <&cru PCLK_VO>, <&cru ACLK_VOP_PRE>;
		pm_qos = <&qos_hdcp &qos_vop_m0 &qos_vop_m1>;
	};

	power-domain@10 {
		clocks = <&cru HCLK_RGA_PRE>, <&cru PCLK_RGA_PRE>;
		pm_qos = <&qos_ebc &qos_iep &qos_jpeg_dec &qos_jpeg_enc &qos_rga_rd &qos_rga_wr>;
	};

	power-domain@11 {
		clocks = <&cru HCLK_VPU_PRE>;
		pm_qos = <&qos_vpu>;
	};

	power-domain@13 {
		clocks = <&cru HCLK_RKVDEC_PRE>;
		pm_qos = <&qos_rkvdec>;
	};

	power-domain@14 {
		clocks = <&cru HCLK_RKVENC_PRE>;
		pm_qos = <&qos_rkvenc_rd_m0 &qos_rkvenc_rd_m1 &qos_rkvenc_wr_m0>;
	};

	power-domain@15 {
		clocks = <&cru PCLK_PIPE>;
		pm_qos = <&qos_pcie2x1 &qos_pcie3x1 &qos_pcie3x2 &qos_sata0 &qos_sata1 &qos_sata2 &qos_usb3_0 &qos_usb3_1>;
	};
};

&pwm0 {
	clocks = <&pmucru CLK_PWM0>, <&pmucru PCLK_PWM0>;
	pinctrl-0 = <&pwm0m0_pins>;
};

&pwm0m0_pins {
	rockchip,pins = <0 RK_PB7 1 &pcfg_pull_none>;
};

&pwm0m1_pins {
	rockchip,pins = <0 RK_PC7 2 &pcfg_pull_none>;
};

&pwm1 {
	clocks = <&pmucru CLK_PWM0>, <&pmucru PCLK_PWM0>;
	pinctrl-0 = <&pwm1m0_pins>;
};

&pwm10 {
	clocks = <&cru CLK_PWM2>, <&cru PCLK_PWM2>;
	pinctrl-0 = <&pwm10m0_pins>;
};

&pwm10m0_pins {
	rockchip,pins = <3 RK_PB5 5 &pcfg_pull_none>;
};

&pwm10m1_pins {
	rockchip,pins = <2 RK_PA1 2 &pcfg_pull_none>;
};

&pwm11 {
	clocks = <&cru CLK_PWM2>, <&cru PCLK_PWM2>;
	pinctrl-0 = <&pwm11m0_pins>;
};

&pwm11m0_pins {
	rockchip,pins = <3 RK_PB6 5 &pcfg_pull_none>;
};

&pwm11m1_pins {
	rockchip,pins = <4 RK_PC0 3 &pcfg_pull_none>;
};

&pwm12 {
	clocks = <&cru CLK_PWM3>, <&cru PCLK_PWM3>;
	pinctrl-0 = <&pwm12m1_pins>;
	status = "okay";
};

&pwm12m0_pins {
	rockchip,pins = <3 RK_PB7 2 &pcfg_pull_none>;
};

&pwm12m1_pins {
	rockchip,pins = <4 RK_PC5 1 &pcfg_pull_none>;
};

&pwm13 {
	clocks = <&cru CLK_PWM3>, <&cru PCLK_PWM3>;
	pinctrl-0 = <&pwm13m1_pins>;
	status = "okay";
};

&pwm13m0_pins {
	rockchip,pins = <3 RK_PC0 2 &pcfg_pull_none>;
};

&pwm13m1_pins {
	rockchip,pins = <4 RK_PC6 1 &pcfg_pull_none>;
};

&pwm14 {
	clocks = <&cru CLK_PWM3>, <&cru PCLK_PWM3>;
	pinctrl-0 = <&pwm14m0_pins>;
};

&pwm14m0_pins {
	rockchip,pins = <3 RK_PC4 1 &pcfg_pull_none>;
};

&pwm14m1_pins {
	rockchip,pins = <4 RK_PC2 1 &pcfg_pull_none>;
};

&pwm15 {
	clocks = <&cru CLK_PWM3>, <&cru PCLK_PWM3>;
	pinctrl-0 = <&pwm15m0_pins>;
};

&pwm15m0_pins {
	rockchip,pins = <3 RK_PC5 1 &pcfg_pull_none>;
};

&pwm15m1_pins {
	rockchip,pins = <4 RK_PC3 1 &pcfg_pull_none>;
};

&pwm1m0_pins {
	rockchip,pins = <0 RK_PC0 1 &pcfg_pull_none>;
};

&pwm1m1_pins {
	rockchip,pins = <0 RK_PB5 4 &pcfg_pull_none>;
};

&pwm2 {
	clocks = <&pmucru CLK_PWM0>, <&pmucru PCLK_PWM0>;
	pinctrl-0 = <&pwm2m0_pins>;
};

&pwm2m0_pins {
	rockchip,pins = <0 RK_PC1 1 &pcfg_pull_none>;
};

&pwm2m1_pins {
	rockchip,pins = <0 RK_PB6 4 &pcfg_pull_none>;
};

&pwm3 {
	clocks = <&pmucru CLK_PWM0>, <&pmucru PCLK_PWM0>;
	pinctrl-0 = <&pwm3_pins>;
};

&pwm3_pins {
	rockchip,pins = <0 RK_PC2 1 &pcfg_pull_none>;
};

&pwm4 {
	clocks = <&cru CLK_PWM1>, <&cru PCLK_PWM1>;
	pinctrl-0 = <&pwm4_pins>;
};

&pwm4_pins {
	rockchip,pins = <0 RK_PC3 1 &pcfg_pull_none>;
};

&pwm5 {
	clocks = <&cru CLK_PWM1>, <&cru PCLK_PWM1>;
	pinctrl-0 = <&pwm5_pins>;
};

&pwm5_pins {
	rockchip,pins = <0 RK_PC4 1 &pcfg_pull_none>;
};

&pwm6 {
	clocks = <&cru CLK_PWM1>, <&cru PCLK_PWM1>;
	pinctrl-0 = <&pwm6_pins>;
};

&pwm6_pins {
	rockchip,pins = <0 RK_PC5 1 &pcfg_pull_none>;
};

&pwm7 {
	clocks = <&cru CLK_PWM1>, <&cru PCLK_PWM1>;
	pinctrl-0 = <&pwm7_pins>;
};

&pwm7_pins {
	rockchip,pins = <0 RK_PC6 1 &pcfg_pull_none>;
};

&pwm8 {
	clocks = <&cru CLK_PWM2>, <&cru PCLK_PWM2>;
	pinctrl-0 = <&pwm8m0_pins>;
};

&pwm8m0_pins {
	rockchip,pins = <3 RK_PB1 5 &pcfg_pull_none>;
};

&pwm8m1_pins {
	rockchip,pins = <1 RK_PD5 4 &pcfg_pull_none>;
};

&pwm9 {
	clocks = <&cru CLK_PWM2>, <&cru PCLK_PWM2>;
	pinctrl-0 = <&pwm9m0_pins>;
};

&pwm9m0_pins {
	rockchip,pins = <3 RK_PB2 5 &pcfg_pull_none>;
};

&pwm9m1_pins {
	rockchip,pins = <1 RK_PD6 4 &pcfg_pull_none>;
};

&refclk_pins {
	rockchip,pins = <0 RK_PA0 1 &pcfg_pull_none>;
};

&rgb {
	pinctrl-0 = <&lcdc_ctl>;
};

&rgb_in_vp2 {
	remote-endpoint = <&vp2_out_rgb>;
};

&rk_rga {
	clocks = <&cru ACLK_RGA>, <&cru HCLK_RGA>, <&cru CLK_RGA_CORE>;
	power-domains = <&power 10>;
	status = "okay";
};

&rkcif {
	clocks = <&cru ACLK_VICAP>, <&cru HCLK_VICAP>, <&cru DCLK_VICAP>, <&cru ICLK_VICAP_G>;
	resets = <&cru SRST_A_VICAP>, <&cru SRST_H_VICAP>, <&cru SRST_D_VICAP>, <&cru SRST_P_VICAP>, <&cru SRST_I_VICAP>;
	assigned-clocks = <&cru DCLK_VICAP>;
	power-domains = <&power 8>;
	rockchip,grf = <&grf>;
	iommus = <&rkcif_mmu>;
};

&rkcif_dvp {
	rockchip,hw = <&rkcif>;
};

&rkcif_dvp_sditf {
	rockchip,cif = <&rkcif_dvp>;
};

&rkcif_mipi_lvds {
	rockchip,hw = <&rkcif>;
};

&rkcif_mipi_lvds_sditf {
	rockchip,cif = <&rkcif_mipi_lvds>;
};

&rkcif_mmu {
	clocks = <&cru ACLK_VICAP>, <&cru HCLK_VICAP>;
	power-domains = <&power 8>;
};

&rkisp {
	clocks = <&cru ACLK_ISP>, <&cru HCLK_ISP>, <&cru CLK_ISP>;
	resets = <&cru SRST_ISP>, <&cru SRST_H_ISP>;
	rockchip,grf = <&grf>;
	power-domains = <&power 8>;
	iommus = <&rkisp_mmu>;
};

&rkisp_mmu {
	clocks = <&cru ACLK_ISP>, <&cru HCLK_ISP>;
	power-domains = <&power 8>;
};

&rkisp_vir0 {
	rockchip,hw = <&rkisp>;
};

&rkisp_vir1 {
	rockchip,hw = <&rkisp>;
};

&rknpu {
	clocks = <&scmi_clk 2>, <&cru CLK_NPU>, <&cru ACLK_NPU>, <&cru HCLK_NPU>;
	assigned-clocks = <&cru CLK_NPU>;
	resets = <&cru SRST_A_NPU>, <&cru SRST_H_NPU>;
	power-domains = <&power 6>;
	operating-points-v2 = <&npu_opp_table>;
	iommus = <&rknpu_mmu>;
};

&rknpu_mmu {
	clocks = <&cru ACLK_NPU>, <&cru HCLK_NPU>;
	power-domains = <&power 6>;
};

&rktimer {
	clocks = <&cru PCLK_TIMER>, <&cru CLK_TIMER0>;
};

&rkvdec {
	clocks = <&cru ACLK_RKVDEC>, <&cru HCLK_RKVDEC>, <&cru CLK_RKVDEC_CA>, <&cru CLK_RKVDEC_CORE>, <&cru CLK_RKVDEC_HEVC_CA>;
	resets = <&cru SRST_A_RKVDEC>, <&cru SRST_H_RKVDEC>, <&cru SRST_RKVDEC_CA>, <&cru SRST_RKVDEC_CORE>, <&cru SRST_RKVDEC_HEVC_CA>;
	assigned-clocks = <&cru ACLK_RKVDEC>, <&cru CLK_RKVDEC_CA>, <&cru CLK_RKVDEC_CORE>, <&cru CLK_RKVDEC_HEVC_CA>;
	power-domains = <&power 13>;
	operating-points-v2 = <&rkvdec_opp_table>;
	vdec-supply = <&vdd_logic>;
	iommus = <&rkvdec_mmu>;
	rockchip,srv = <&mpp_srv>;
	rockchip,sram = <&rkvdec_sram>;
	status = "okay";
};

&rkvdec_mmu {
	clocks = <&cru ACLK_RKVDEC>, <&cru HCLK_RKVDEC>;
	power-domains = <&power 13>;
	status = "okay";
};

&rkvdec_opp_table {
	nvmem-cells = <&log_leakage &core_pvtm>;
};

&rkvenc {
	clocks = <&cru ACLK_RKVENC>, <&cru HCLK_RKVENC>, <&cru CLK_RKVENC_CORE>;
	resets = <&cru SRST_A_RKVENC>, <&cru SRST_H_RKVENC>, <&cru SRST_RKVENC_CORE>;
	assigned-clocks = <&cru ACLK_RKVENC>, <&cru CLK_RKVENC_CORE>;
	iommus = <&rkvenc_mmu>;
	rockchip,srv = <&mpp_srv>;
	power-domains = <&power 14>;
	operating-points-v2 = <&rkvenc_opp_table>;
	status = "okay";
};

&rkvenc_mmu {
	clocks = <&cru ACLK_RKVENC>, <&cru HCLK_RKVENC>;
	power-domains = <&power 14>;
	status = "okay";
};

&rkvenc_opp_table {
	nvmem-cells = <&core_pvtm>;
};

&rng {
	clocks = <&cru CLK_TRNG_NS>, <&cru HCLK_TRNG_NS>;
	resets = <&cru SRST_TRNG_NS>;
};

&route_dsi0 {
	status = "okay";
	connect = <&vp0_out_dsi0>;
};

&route_dsi1 {
	status = "okay";
	connect = <&vp1_out_dsi1>;
};

&route_edp {
	connect = <&vp0_out_edp>;
};

&route_hdmi {
	connect = <&vp0_out_hdmi>;
};

&route_lvds {
	connect = <&vp1_out_lvds>;
};

&route_rgb {
	connect = <&vp2_out_rgb>;
};

&saradc {
	clocks = <&cru CLK_SARADC>, <&cru PCLK_SARADC>;
	resets = <&cru SRST_P_SARADC>;
	status = "okay";
	vref-supply = <&vcc_1v8>;
};

&sata0 {
	clocks = <&cru ACLK_SATA0>, <&cru CLK_SATA0_PMALIVE>, <&cru CLK_SATA0_RXOOB>;
	phys = <&combphy0_us 1>;
	power-domains = <&power 15>;
};

&sata0_pins {
	rockchip,pins = <4 RK_PC6 3 &pcfg_pull_none>;
};

&sata1 {
	clocks = <&cru ACLK_SATA1>, <&cru CLK_SATA1_PMALIVE>, <&cru CLK_SATA1_RXOOB>;
	phys = <&combphy1_usq 1>;
	power-domains = <&power 15>;
};

&sata1_pins {
	rockchip,pins = <4 RK_PC5 3 &pcfg_pull_none>;
};

&sata2 {
	clocks = <&cru ACLK_SATA2>, <&cru CLK_SATA2_PMALIVE>, <&cru CLK_SATA2_RXOOB>;
	phys = <&combphy2_psq 1>;
	power-domains = <&power 15>;
};

&sata2_pins {
	rockchip,pins = <4 RK_PC4 3 &pcfg_pull_none>;
};

&sata_pins {
	rockchip,pins = <0 RK_PA4 2 &pcfg_pull_none>,
			<0 RK_PA6 1 &pcfg_pull_none>,
			<0 RK_PA5 2 &pcfg_pull_none>;
};

&scmi {
	shmem = <&scmi_shmem>;
};

&scr {
	pinctrl-0 = <&scr_pins>;
	clocks = <&cru PCLK_SCR>;
};

&scr_pins {
	rockchip,pins = <1 RK_PA2 3 &pcfg_pull_none>,
			<1 RK_PA7 3 &pcfg_pull_up>,
			<1 RK_PA3 3 &pcfg_pull_up>,
			<1 RK_PA5 3 &pcfg_pull_none>;
};

&sdhci {
	assigned-clocks = <&cru BCLK_EMMC>, <&cru TCLK_EMMC>, <&cru CCLK_EMMC>;
	clocks = <&cru CCLK_EMMC>, <&cru HCLK_EMMC>, <&cru ACLK_EMMC>, <&cru BCLK_EMMC>, <&cru TCLK_EMMC>;
	resets = <&cru SRST_C_EMMC>, <&cru SRST_H_EMMC>, <&cru SRST_A_EMMC>, <&cru SRST_B_EMMC>, <&cru SRST_T_EMMC>;
	status = "okay";
	bus-width = <8>;
	no-sdio;
	no-sd;
	non-removable;
	max-frequency = <200000000>;
};

&sdmmc0 {
	clocks = <&cru HCLK_SDMMC0>, <&cru CLK_SDMMC0>, <&cru SCLK_SDMMC0_DRV>, <&cru SCLK_SDMMC0_SAMPLE>;
	resets = <&cru SRST_SDMMC0>;
	status = "okay";
	no-sdio;
	no-mmc;
	bus-width = <4>;
	cap-mmc-highspeed;
	cap-sd-highspeed;
	disable-wp;
	sd-uhs-sdr104;
	vmmc-supply = <&vcc_sd>;
	vqmmc-supply = <&vccio_sd>;
	pinctrl-names = "default";
	pinctrl-0 = <&sdmmc0_bus4 &sdmmc0_clk &sdmmc0_cmd &sdmmc0_det>;
};

&sdmmc0_bus4 {
	rockchip,pins = <1 RK_PD5 1 &pcfg_pull_up_drv_level_2>,
			<1 RK_PD6 1 &pcfg_pull_up_drv_level_2>,
			<1 RK_PD7 1 &pcfg_pull_up_drv_level_2>,
			<2 RK_PA0 1 &pcfg_pull_up_drv_level_2>;
};

&sdmmc0_clk {
	rockchip,pins = <2 RK_PA2 1 &pcfg_pull_up_drv_level_2>;
};

&sdmmc0_cmd {
	rockchip,pins = <2 RK_PA1 1 &pcfg_pull_up_drv_level_2>;
};

&sdmmc0_det {
	rockchip,pins = <0 RK_PA4 1 &pcfg_pull_up>;
};

&sdmmc0_pwren {
	rockchip,pins = <0 RK_PA5 1 &pcfg_pull_none>;
};

&sdmmc1 {
	clocks = <&cru HCLK_SDMMC1>, <&cru CLK_SDMMC1>, <&cru SCLK_SDMMC1_DRV>, <&cru SCLK_SDMMC1_SAMPLE>;
	resets = <&cru SRST_SDMMC1>;
};

&sdmmc1_bus4 {
	rockchip,pins = <2 RK_PA3 1 &pcfg_pull_up_drv_level_2>,
			<2 RK_PA4 1 &pcfg_pull_up_drv_level_2>,
			<2 RK_PA5 1 &pcfg_pull_up_drv_level_2>,
			<2 RK_PA6 1 &pcfg_pull_up_drv_level_2>;
};

&sdmmc1_clk {
	rockchip,pins = <2 RK_PB0 1 &pcfg_pull_up_drv_level_2>;
};

&sdmmc1_cmd {
	rockchip,pins = <2 RK_PA7 1 &pcfg_pull_up_drv_level_2>;
};

&sdmmc1_det {
	rockchip,pins = <2 RK_PB2 1 &pcfg_pull_up>;
};

&sdmmc1_pwren {
	rockchip,pins = <2 RK_PB1 1 &pcfg_pull_none>;
};

&sdmmc2 {
	clocks = <&cru HCLK_SDMMC2>, <&cru CLK_SDMMC2>, <&cru SCLK_SDMMC2_DRV>, <&cru SCLK_SDMMC2_SAMPLE>;
	max-frequency = <100000000>;
	resets = <&cru SRST_SDMMC2>;
	status = "okay";
	no-sd;
	no-mmc;
	bus-width = <4>;
	disable-wp;
	cap-sd-highspeed;
	cap-sdio-irq;
	keep-power-in-suspend;
	mmc-pwrseq = <&sdio_pwrseq>;
	non-removable;
	pinctrl-names = "default";
	pinctrl-0 = <&sdmmc2m0_bus4 &sdmmc2m0_cmd &sdmmc2m0_clk>;
	sd-uhs-sdr12;
	sd-uhs-sdr25;
	sd-uhs-sdr50;
	sd-uhs-sdr104;
	rockchip,default-sample-phase = <90>;
};

&sdmmc2m0_bus4 {
	rockchip,pins = <3 RK_PC6 3 &pcfg_pull_up_drv_level_2>,
			<3 RK_PC7 3 &pcfg_pull_up_drv_level_2>,
			<3 RK_PD0 3 &pcfg_pull_up_drv_level_2>,
			<3 RK_PD1 3 &pcfg_pull_up_drv_level_2>;
};

&sdmmc2m0_clk {
	rockchip,pins = <3 RK_PD3 3 &pcfg_pull_up_drv_level_2>;
};

&sdmmc2m0_cmd {
	rockchip,pins = <3 RK_PD2 3 &pcfg_pull_up_drv_level_2>;
};

&sdmmc2m0_det {
	rockchip,pins = <3 RK_PD4 3 &pcfg_pull_up>;
};

&sdmmc2m0_pwren {
	rockchip,pins = <3 RK_PD5 3 &pcfg_pull_none>;
};

&sdmmc2m1_bus4 {
	rockchip,pins = <3 RK_PA1 5 &pcfg_pull_up_drv_level_2>,
			<3 RK_PA2 5 &pcfg_pull_up_drv_level_2>,
			<3 RK_PA3 5 &pcfg_pull_up_drv_level_2>,
			<3 RK_PA4 5 &pcfg_pull_up_drv_level_2>;
};

&sdmmc2m1_clk {
	rockchip,pins = <3 RK_PA6 5 &pcfg_pull_up_drv_level_2>;
};

&sdmmc2m1_cmd {
	rockchip,pins = <3 RK_PA5 5 &pcfg_pull_up_drv_level_2>;
};

&sdmmc2m1_det {
	rockchip,pins = <3 RK_PA7 4 &pcfg_pull_up>;
};

&sdmmc2m1_pwren {
	rockchip,pins = <3 RK_PB0 4 &pcfg_pull_none>;
};

&sfc {
	clocks = <&cru SCLK_SFC>, <&cru HCLK_SFC>;
	assigned-clocks = <&cru SCLK_SFC>;
};

&soc_thermal {
	thermal-sensors = <&tsadc 0>;

	cooling-maps {
		map0 {
			trip = <&target>;
			cooling-device = <&cpu0 4294967295 4294967295>;
		};

		map1 {
			trip = <&target>;
			cooling-device = <&gpu 4294967295 4294967295>;
		};
	};
};

&spdif_8ch {
	clocks = <&cru MCLK_SPDIF_8CH>, <&cru HCLK_SPDIF_8CH>;
	dmas = <&dmac1 1>;
	pinctrl-0 = <&spdifm0_tx>;
};

&spdifm0_tx {
	rockchip,pins = <1 RK_PA4 4 &pcfg_pull_none>;
};

&spdifm1_tx {
	rockchip,pins = <3 RK_PC5 2 &pcfg_pull_none>;
};

&spdifm2_tx {
	rockchip,pins = <4 RK_PC4 2 &pcfg_pull_none>;
};

&spi0 {
	clocks = <&cru CLK_SPI0>, <&cru PCLK_SPI0>;
	dmas = <&dmac0 20>, <&dmac0 21>;
	pinctrl-0 = <&spi0m0_cs0 &spi0m0_cs1 &spi0m0_pins>;
	pinctrl-1 = <&spi0m0_cs0 &spi0m0_cs1 &spi0m0_pins_hs>;
};

&spi0m0_cs0 {
	rockchip,pins = <0 RK_PC6 2 &pcfg_pull_none>;
};

&spi0m0_cs0_hs {
	rockchip,pins = <0 RK_PC6 2 &pcfg_pull_up_drv_level_1>;
};

&spi0m0_cs1 {
	rockchip,pins = <0 RK_PC4 2 &pcfg_pull_none>;
};

&spi0m0_cs1_hs {
	rockchip,pins = <0 RK_PC4 2 &pcfg_pull_up_drv_level_1>;
};

&spi0m0_pins {
	rockchip,pins = <0 RK_PB5 2 &pcfg_pull_none>,
			<0 RK_PC5 2 &pcfg_pull_none>,
			<0 RK_PB6 2 &pcfg_pull_none>;
};

&spi0m0_pins_hs {
	rockchip,pins = <0 RK_PB5 2 &pcfg_pull_up_drv_level_1>,
			<0 RK_PC5 2 &pcfg_pull_up_drv_level_1>,
			<0 RK_PB6 2 &pcfg_pull_up_drv_level_1>;
};

&spi0m1_cs0 {
	rockchip,pins = <2 RK_PD2 3 &pcfg_pull_none>;
};

&spi0m1_cs0_hs {
	rockchip,pins = <2 RK_PD2 3 &pcfg_pull_up_drv_level_1>;
};

&spi0m1_pins {
	rockchip,pins = <2 RK_PD3 3 &pcfg_pull_none>,
			<2 RK_PD0 3 &pcfg_pull_none>,
			<2 RK_PD1 3 &pcfg_pull_none>;
};

&spi0m1_pins_hs {
	rockchip,pins = <2 RK_PD3 3 &pcfg_pull_up_drv_level_1>,
			<2 RK_PD0 3 &pcfg_pull_up_drv_level_1>,
			<2 RK_PD1 3 &pcfg_pull_up_drv_level_1>;
};

&spi1 {
	clocks = <&cru CLK_SPI1>, <&cru PCLK_SPI1>;
	dmas = <&dmac0 22>, <&dmac0 23>;
	pinctrl-0 = <&spi1m0_cs0 &spi1m0_cs1 &spi1m0_pins>;
	pinctrl-1 = <&spi1m0_cs0 &spi1m0_cs1 &spi1m0_pins_hs>;
};

&spi1m0_cs0 {
	rockchip,pins = <2 RK_PC0 4 &pcfg_pull_none>;
};

&spi1m0_cs0_hs {
	rockchip,pins = <2 RK_PC0 4 &pcfg_pull_up_drv_level_1>;
};

&spi1m0_cs1 {
	rockchip,pins = <2 RK_PC6 3 &pcfg_pull_none>;
};

&spi1m0_cs1_hs {
	rockchip,pins = <2 RK_PC6 3 &pcfg_pull_up_drv_level_1>;
};

&spi1m0_pins {
	rockchip,pins = <2 RK_PB5 3 &pcfg_pull_none>,
			<2 RK_PB6 3 &pcfg_pull_none>,
			<2 RK_PB7 4 &pcfg_pull_none>;
};

&spi1m0_pins_hs {
	rockchip,pins = <2 RK_PB5 3 &pcfg_pull_up_drv_level_1>,
			<2 RK_PB6 3 &pcfg_pull_up_drv_level_1>,
			<2 RK_PB7 4 &pcfg_pull_up_drv_level_1>;
};

&spi1m1_cs0 {
	rockchip,pins = <3 RK_PA1 3 &pcfg_pull_none>;
};

&spi1m1_cs0_hs {
	rockchip,pins = <3 RK_PA1 3 &pcfg_pull_up_drv_level_1>;
};

&spi1m1_pins {
	rockchip,pins = <3 RK_PC3 3 &pcfg_pull_none>,
			<3 RK_PC2 3 &pcfg_pull_none>,
			<3 RK_PC1 3 &pcfg_pull_none>;
};

&spi1m1_pins_hs {
	rockchip,pins = <3 RK_PC3 3 &pcfg_pull_up_drv_level_1>,
			<3 RK_PC2 3 &pcfg_pull_up_drv_level_1>,
			<3 RK_PC1 3 &pcfg_pull_up_drv_level_1>;
};

&spi2 {
	clocks = <&cru CLK_SPI2>, <&cru PCLK_SPI2>;
	dmas = <&dmac0 24>, <&dmac0 25>;
	pinctrl-0 = <&spi2m0_cs0 &spi2m0_cs1 &spi2m0_pins>;
	pinctrl-1 = <&spi2m0_cs0 &spi2m0_cs1 &spi2m0_pins_hs>;
};

&spi2m0_cs0 {
	rockchip,pins = <2 RK_PC4 4 &pcfg_pull_none>;
};

&spi2m0_cs0_hs {
	rockchip,pins = <2 RK_PC4 4 &pcfg_pull_up_drv_level_1>;
};

&spi2m0_cs1 {
	rockchip,pins = <2 RK_PC5 4 &pcfg_pull_none>;
};

&spi2m0_cs1_hs {
	rockchip,pins = <2 RK_PC5 4 &pcfg_pull_up_drv_level_1>;
};

&spi2m0_pins {
	rockchip,pins = <2 RK_PC1 4 &pcfg_pull_none>,
			<2 RK_PC2 4 &pcfg_pull_none>,
			<2 RK_PC3 4 &pcfg_pull_none>;
};

&spi2m0_pins_hs {
	rockchip,pins = <2 RK_PC1 4 &pcfg_pull_up_drv_level_1>,
			<2 RK_PC2 4 &pcfg_pull_up_drv_level_1>,
			<2 RK_PC3 4 &pcfg_pull_up_drv_level_1>;
};

&spi2m1_cs0 {
	rockchip,pins = <2 RK_PD5 3 &pcfg_pull_none>;
};

&spi2m1_cs0_hs {
	rockchip,pins = <2 RK_PD5 3 &pcfg_pull_up_drv_level_1>;
};

&spi2m1_cs1 {
	rockchip,pins = <2 RK_PD4 3 &pcfg_pull_none>;
};

&spi2m1_cs1_hs {
	rockchip,pins = <2 RK_PD4 3 &pcfg_pull_up_drv_level_1>;
};

&spi2m1_pins {
	rockchip,pins = <3 RK_PA0 3 &pcfg_pull_none>,
			<2 RK_PD7 3 &pcfg_pull_none>,
			<2 RK_PD6 3 &pcfg_pull_none>;
};

&spi2m1_pins_hs {
	rockchip,pins = <3 RK_PA0 3 &pcfg_pull_up_drv_level_1>,
			<2 RK_PD7 3 &pcfg_pull_up_drv_level_1>,
			<2 RK_PD6 3 &pcfg_pull_up_drv_level_1>;
};

&spi3 {
	clocks = <&cru CLK_SPI3>, <&cru PCLK_SPI3>;
	dmas = <&dmac0 26>, <&dmac0 27>;
	pinctrl-0 = <&spi3m0_cs0 &spi3m0_cs1 &spi3m0_pins>;
	pinctrl-1 = <&spi3m0_cs0 &spi3m0_cs1 &spi3m0_pins_hs>;
};

&spi3m0_cs0 {
	rockchip,pins = <4 RK_PA6 4 &pcfg_pull_none>;
};

&spi3m0_cs0_hs {
	rockchip,pins = <4 RK_PA6 4 &pcfg_pull_up_drv_level_1>;
};

&spi3m0_cs1 {
	rockchip,pins = <4 RK_PA7 4 &pcfg_pull_none>;
};

&spi3m0_cs1_hs {
	rockchip,pins = <4 RK_PA7 4 &pcfg_pull_up_drv_level_1>;
};

&spi3m0_pins {
	rockchip,pins = <4 RK_PB3 4 &pcfg_pull_none>,
			<4 RK_PB0 4 &pcfg_pull_none>,
			<4 RK_PB2 4 &pcfg_pull_none>;
};

&spi3m0_pins_hs {
	rockchip,pins = <4 RK_PB3 4 &pcfg_pull_up_drv_level_1>,
			<4 RK_PB0 4 &pcfg_pull_up_drv_level_1>,
			<4 RK_PB2 4 &pcfg_pull_up_drv_level_1>;
};

&spi3m1_cs0 {
	rockchip,pins = <4 RK_PC6 2 &pcfg_pull_none>;
};

&spi3m1_cs0_hs {
	rockchip,pins = <4 RK_PC6 2 &pcfg_pull_up_drv_level_1>;
};

&spi3m1_cs1 {
	rockchip,pins = <4 RK_PD1 2 &pcfg_pull_none>;
};

&spi3m1_cs1_hs {
	rockchip,pins = <4 RK_PD1 2 &pcfg_pull_up_drv_level_1>;
};

&spi3m1_pins {
	rockchip,pins = <4 RK_PC2 2 &pcfg_pull_none>,
			<4 RK_PC5 2 &pcfg_pull_none>,
			<4 RK_PC3 2 &pcfg_pull_none>;
};

&spi3m1_pins_hs {
	rockchip,pins = <4 RK_PC2 2 &pcfg_pull_up_drv_level_1>,
			<4 RK_PC5 2 &pcfg_pull_up_drv_level_1>,
			<4 RK_PC3 2 &pcfg_pull_up_drv_level_1>;
};

&tsadc {
	assigned-clocks = <&cru CLK_TSADC_TSEN>, <&cru CLK_TSADC>;
	clocks = <&cru CLK_TSADC>, <&cru PCLK_TSADC>;
	resets = <&cru SRST_TSADC>, <&cru SRST_P_TSADC>, <&cru SRST_TSADCPHY>;
	rockchip,grf = <&grf>;
	nvmem-cells = <&tsadc_trim_base &tsadc_trim_base_frac>;
	pinctrl-0 = <&tsadc_gpio_func>;
	pinctrl-1 = <&tsadc_shutorg>;
	status = "okay";

	tsadc@0 {
		nvmem-cells = <&cpu_tsadc_trim_l &cpu_tsadc_trim_h>;
	};

	tsadc@1 {
		nvmem-cells = <&gpu_tsadc_trim_l &gpu_tsadc_trim_h>;
	};
};

&tsadc_gpio_func {
	rockchip,pins = <0 RK_PA1 RK_FUNC_GPIO &pcfg_pull_none>;
};

&tsadc_shutorg {
	rockchip,pins = <0 RK_PA1 2 &pcfg_pull_none>;
};

&tsadcm0_shut {
	rockchip,pins = <0 RK_PA1 1 &pcfg_pull_none>;
};

&tsadcm1_shut {
	rockchip,pins = <0 RK_PA2 2 &pcfg_pull_none>;
};

&u2phy0_host {
	status = "okay";
};

&u2phy0_otg {
	status = "okay";
	rockchip,dis-u2-susphy;
	vbus-supply = <&vcc5v0_otg>;
};

&u2phy1_host {
	status = "okay";
};

&u2phy1_otg {
	status = "okay";
};

&uart0 {
	clocks = <&pmucru SCLK_UART0>, <&pmucru PCLK_UART0>;
	dmas = <&dmac0 0>, <&dmac0 1>;
	pinctrl-0 = <&uart0_xfer>;
};

&uart0_ctsn {
	rockchip,pins = <0 RK_PC7 3 &pcfg_pull_none>;
};

&uart0_rtsn {
	rockchip,pins = <0 RK_PC4 3 &pcfg_pull_none>;
};

&uart0_xfer {
	rockchip,pins = <0 RK_PC0 3 &pcfg_pull_up>,
			<0 RK_PC1 3 &pcfg_pull_up>;
};

&uart1 {
	clocks = <&cru SCLK_UART1>, <&cru PCLK_UART1>;
	dmas = <&dmac0 2>, <&dmac0 3>;
	pinctrl-0 = <&uart1m1_xfer &uart1m1_ctsn>;
	status = "okay";
};

&uart1m0_ctsn {
	rockchip,pins = <2 RK_PB6 2 &pcfg_pull_none>;
};

&uart1m0_rtsn {
	rockchip,pins = <2 RK_PB5 2 &pcfg_pull_none>;
};

&uart1m0_xfer {
	rockchip,pins = <2 RK_PB3 2 &pcfg_pull_up>,
			<2 RK_PB4 2 &pcfg_pull_up>;
};

&uart1m1_ctsn {
	rockchip,pins = <4 RK_PC1 4 &pcfg_pull_none>;
};

&uart1m1_rtsn {
	rockchip,pins = <4 RK_PB6 4 &pcfg_pull_none>;
};

&uart1m1_xfer {
	rockchip,pins = <3 RK_PD7 4 &pcfg_pull_up>,
			<3 RK_PD6 4 &pcfg_pull_up>;
};

&uart2 {
	clocks = <&cru SCLK_UART2>, <&cru PCLK_UART2>;
	dmas = <&dmac0 4>, <&dmac0 5>;
	pinctrl-0 = <&uart2m0_xfer>;
};

&uart2m0_xfer {
	rockchip,pins = <0 RK_PD0 1 &pcfg_pull_up>,
			<0 RK_PD1 1 &pcfg_pull_up>;
};

&uart2m1_xfer {
	rockchip,pins = <1 RK_PD6 2 &pcfg_pull_up>,
			<1 RK_PD5 2 &pcfg_pull_up>;
};

&uart3 {
	clocks = <&cru SCLK_UART3>, <&cru PCLK_UART3>;
	dmas = <&dmac0 6>, <&dmac0 7>;
	pinctrl-0 = <&uart3m0_xfer>;
};

&uart3m0_ctsn {
	rockchip,pins = <1 RK_PA3 2 &pcfg_pull_none>;
};

&uart3m0_rtsn {
	rockchip,pins = <1 RK_PA2 2 &pcfg_pull_none>;
};

&uart3m0_xfer {
	rockchip,pins = <1 RK_PA0 2 &pcfg_pull_up>,
			<1 RK_PA1 2 &pcfg_pull_up>;
};

&uart3m1_xfer {
	rockchip,pins = <3 RK_PC0 4 &pcfg_pull_up>,
			<3 RK_PB7 4 &pcfg_pull_up>;
};

&uart4 {
	clocks = <&cru SCLK_UART4>, <&cru PCLK_UART4>;
	dmas = <&dmac0 8>, <&dmac0 9>;
	pinctrl-0 = <&uart4m0_xfer>;
};

&uart4m0_ctsn {
	rockchip,pins = <1 RK_PA7 2 &pcfg_pull_none>;
};

&uart4m0_rtsn {
	rockchip,pins = <1 RK_PA5 2 &pcfg_pull_none>;
};

&uart4m0_xfer {
	rockchip,pins = <1 RK_PA4 2 &pcfg_pull_up>,
			<1 RK_PA6 2 &pcfg_pull_up>;
};

&uart4m1_xfer {
	rockchip,pins = <3 RK_PB1 4 &pcfg_pull_up>,
			<3 RK_PB2 4 &pcfg_pull_up>;
};

&uart5 {
	clocks = <&cru SCLK_UART5>, <&cru PCLK_UART5>;
	dmas = <&dmac0 10>, <&dmac0 11>;
	pinctrl-0 = <&uart5m0_xfer>;
};

&uart5m0_ctsn {
	rockchip,pins = <1 RK_PD7 3 &pcfg_pull_none>;
};

&uart5m0_rtsn {
	rockchip,pins = <2 RK_PA0 3 &pcfg_pull_none>;
};

&uart5m0_xfer {
	rockchip,pins = <2 RK_PA1 3 &pcfg_pull_up>,
			<2 RK_PA2 3 &pcfg_pull_up>;
};

&uart5m1_xfer {
	rockchip,pins = <3 RK_PC3 4 &pcfg_pull_up>,
			<3 RK_PC2 4 &pcfg_pull_up>;
};

&uart6 {
	clocks = <&cru SCLK_UART6>, <&cru PCLK_UART6>;
	dmas = <&dmac0 12>, <&dmac0 13>;
	pinctrl-0 = <&uart6m0_xfer>;
};

&uart6m0_ctsn {
	rockchip,pins = <2 RK_PC0 3 &pcfg_pull_none>;
};

&uart6m0_rtsn {
	rockchip,pins = <2 RK_PB7 3 &pcfg_pull_none>;
};

&uart6m0_xfer {
	rockchip,pins = <2 RK_PA3 3 &pcfg_pull_up>,
			<2 RK_PA4 3 &pcfg_pull_up>;
};

&uart6m1_xfer {
	rockchip,pins = <1 RK_PD6 3 &pcfg_pull_up>,
			<1 RK_PD5 3 &pcfg_pull_up>;
};

&uart7 {
	clocks = <&cru SCLK_UART7>, <&cru PCLK_UART7>;
	dmas = <&dmac0 14>, <&dmac0 15>;
	pinctrl-0 = <&uart7m0_xfer>;
};

&uart7m0_ctsn {
	rockchip,pins = <2 RK_PC2 3 &pcfg_pull_none>;
};

&uart7m0_rtsn {
	rockchip,pins = <2 RK_PC1 3 &pcfg_pull_none>;
};

&uart7m0_xfer {
	rockchip,pins = <2 RK_PA5 3 &pcfg_pull_up>,
			<2 RK_PA6 3 &pcfg_pull_up>;
};

&uart7m1_xfer {
	rockchip,pins = <3 RK_PC5 4 &pcfg_pull_up>,
			<3 RK_PC4 4 &pcfg_pull_up>;
};

&uart7m2_xfer {
	rockchip,pins = <4 RK_PA3 4 &pcfg_pull_up>,
			<4 RK_PA2 4 &pcfg_pull_up>;
};

&uart8 {
	clocks = <&cru SCLK_UART8>, <&cru PCLK_UART8>;
	dmas = <&dmac0 16>, <&dmac0 17>;
	pinctrl-0 = <&uart8m0_xfer>;
};

&uart8m0_ctsn {
	rockchip,pins = <2 RK_PB2 3 &pcfg_pull_none>;
};

&uart8m0_rtsn {
	rockchip,pins = <2 RK_PB1 3 &pcfg_pull_none>;
};

&uart8m0_xfer {
	rockchip,pins = <2 RK_PC6 2 &pcfg_pull_up>,
			<2 RK_PC5 3 &pcfg_pull_up>;
};

&uart8m1_xfer {
	rockchip,pins = <3 RK_PA0 4 &pcfg_pull_up>,
			<2 RK_PD7 4 &pcfg_pull_up>;
};

&uart9 {
	clocks = <&cru SCLK_UART9>, <&cru PCLK_UART9>;
	dmas = <&dmac0 18>, <&dmac0 19>;
	pinctrl-0 = <&uart9m0_xfer>;
};

&uart9m0_ctsn {
	rockchip,pins = <2 RK_PC4 3 &pcfg_pull_none>;
};

&uart9m0_rtsn {
	rockchip,pins = <2 RK_PC3 3 &pcfg_pull_none>;
};

&uart9m0_xfer {
	rockchip,pins = <2 RK_PA7 3 &pcfg_pull_up>,
			<2 RK_PB0 3 &pcfg_pull_up>;
};

&uart9m1_xfer {
	rockchip,pins = <4 RK_PC6 4 &pcfg_pull_up>,
			<4 RK_PC5 4 &pcfg_pull_up>;
};

&uart9m2_xfer {
	rockchip,pins = <4 RK_PA5 4 &pcfg_pull_up>,
			<4 RK_PA4 4 &pcfg_pull_up>;
};

&usb2phy0 {
	clocks = <&pmucru CLK_USBPHY0_REF>;
	rockchip,usbgrf = <&usb2phy0_grf>;
	assigned-clocks = <&cru USB480M>;
	assigned-clock-parents = <&usb2phy0>;
	status = "okay";
};

&usb2phy1 {
	clocks = <&pmucru CLK_USBPHY1_REF>;
	rockchip,usbgrf = <&usb2phy1_grf>;
	status = "okay";
};

&usb_host0_ehci {
	clocks = <&cru HCLK_USB2HOST0>, <&cru HCLK_USB2HOST0_ARB>, <&cru PCLK_USB>, <&usb2phy1>;
	phys = <&u2phy1_otg>;
	status = "okay";
};

&usb_host0_ohci {
	clocks = <&cru HCLK_USB2HOST0>, <&cru HCLK_USB2HOST0_ARB>, <&cru PCLK_USB>, <&usb2phy1>;
	phys = <&u2phy1_otg>;
	status = "okay";
};

&usb_host1_ehci {
	clocks = <&cru HCLK_USB2HOST1>, <&cru HCLK_USB2HOST1_ARB>, <&cru PCLK_USB>, <&usb2phy1>;
	phys = <&u2phy1_host>;
	status = "okay";
};

&usb_host1_ohci {
	clocks = <&cru HCLK_USB2HOST1>, <&cru HCLK_USB2HOST1_ARB>, <&cru PCLK_USB>, <&usb2phy1>;
	phys = <&u2phy1_host>;
	status = "okay";
};

&usbdrd30 {
	clocks = <&cru CLK_USB3OTG0_REF>, <&cru CLK_USB3OTG0_SUSPEND>, <&cru ACLK_USB3OTG0>, <&cru PCLK_PIPE>;
	status = "okay";
};

&usbdrd_dwc3 {
	power-domains = <&power 15>;
	resets = <&cru SRST_USB3OTG0>;
	status = "okay";
	phys = <&u2phy0_otg>;
	phy-names = "usb2-phy";
	extcon = <&usb2phy0>;
	maximum-speed = "high-speed";
	snps,dis_u2_susphy_quirk;
	snps,usb2-lpm-disable;
};

&usbhost30 {
	clocks = <&cru CLK_USB3OTG1_REF>, <&cru CLK_USB3OTG1_SUSPEND>, <&cru ACLK_USB3OTG1>, <&cru PCLK_PIPE>;
	status = "okay";
};

&usbhost_dwc3 {
	phys = <&u2phy0_host>, <&combphy1_usq 4>;
	power-domains = <&power 15>;
	resets = <&cru SRST_USB3OTG1>;
};

&vad {
	clocks = <&cru HCLK_VAD>;
};

&vdpu {
	clocks = <&cru ACLK_VPU>, <&cru HCLK_VPU>;
	resets = <&cru SRST_A_VPU>, <&cru SRST_H_VPU>;
	iommus = <&vdpu_mmu>;
	power-domains = <&power 11>;
	rockchip,srv = <&mpp_srv>;
	status = "okay";
};

&vdpu_mmu {
	clocks = <&cru ACLK_VPU>, <&cru HCLK_VPU>;
	power-domains = <&power 11>;
	status = "okay";
};

&vendor_storage {
	memory-region = <&vendor_storage_rm>;
};

&vepu {
	clocks = <&cru ACLK_JENC>, <&cru HCLK_JENC>;
	resets = <&cru SRST_A_JENC>, <&cru SRST_H_JENC>;
	iommus = <&vepu_mmu>;
	rockchip,srv = <&mpp_srv>;
	power-domains = <&power 10>;
	status = "okay";
};

&vepu_mmu {
	clocks = <&cru ACLK_JENC>, <&cru HCLK_JENC>;
	power-domains = <&power 10>;
	status = "okay";
};

&video_phy0 {
	clocks = <&pmucru CLK_MIPIDSIPHY0_REF>, <&cru PCLK_MIPIDSIPHY0>, <&cru PCLK_DSITX_0>;
	resets = <&cru SRST_P_MIPIDSIPHY0>;
	power-domains = <&power 9>;
	status = "okay";
};

&video_phy1 {
	clocks = <&pmucru CLK_MIPIDSIPHY1_REF>, <&cru PCLK_MIPIDSIPHY1>, <&cru PCLK_DSITX_1>;
	resets = <&cru SRST_P_MIPIDSIPHY1>;
	power-domains = <&power 9>;
	status = "okay";
};

&vop {
	clocks = <&cru ACLK_VOP>, <&cru HCLK_VOP>, <&cru DCLK_VOP0>, <&cru DCLK_VOP1>, <&cru DCLK_VOP2>;
	operating-points-v2 = <&vop_opp_table>;
	iommus = <&vop_mmu>;
	power-domains = <&power 9>;
	rockchip,grf = <&grf>;
	status = "okay";
	assigned-clocks = <&cru DCLK_VOP0>, <&cru DCLK_VOP1>;
	assigned-clock-parents = <&pmucru PLL_HPLL>, <&cru PLL_VPLL>;
	vop-supply = <&vdd_logic>;
};

&vop_mmu {
	clocks = <&cru ACLK_VOP>, <&cru HCLK_VOP>;
	status = "okay";
};

&vop_opp_table {
	nvmem-cells = <&log_leakage &core_pvtm>;
};

&vopm0_pins {
	rockchip,pins = <0 RK_PC3 2 &pcfg_pull_none>;
};

&vopm1_pins {
	rockchip,pins = <3 RK_PC4 2 &pcfg_pull_none>;
};

&vp0_out_dsi0 {
	remote-endpoint = <&dsi0_in_vp0>;
};

&vp0_out_dsi1 {
	remote-endpoint = <&dsi1_in_vp0>;
};

&vp0_out_edp {
	remote-endpoint = <&edp_in_vp0>;
};

&vp0_out_hdmi {
	remote-endpoint = <&hdmi_in_vp0>;
};

&vp1_out_dsi0 {
	remote-endpoint = <&dsi0_in_vp1>;
};

&vp1_out_dsi1 {
	remote-endpoint = <&dsi1_in_vp1>;
};

&vp1_out_edp {
	remote-endpoint = <&edp_in_vp1>;
};

&vp1_out_hdmi {
	remote-endpoint = <&hdmi_in_vp1>;
};

&vp1_out_lvds {
	remote-endpoint = <&lvds0_in_vp1>;
};

&vp1_out_lvds1 {
	remote-endpoint = <&lvds1_in_vp1>;
};

&vp2_out_lvds {
	remote-endpoint = <&lvds0_in_vp2>;
};

&vp2_out_lvds1 {
	remote-endpoint = <&lvds1_in_vp2>;
};

&vp2_out_rgb {
	remote-endpoint = <&rgb_in_vp2>;
};

&vpu {
	clocks = <&cru ACLK_VPU>, <&cru HCLK_VPU>;
	iommus = <&vdpu_mmu>;
	power-domains = <&power 11>;
};

&wdt {
	clocks = <&cru TCLK_WDT_NS>, <&cru PCLK_WDT_NS>;
};

&xin32k {
	pinctrl-0 = <&clk32k_out0>;
};
